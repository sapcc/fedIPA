## BR2_EXTERNAL/package/python-docutils-stubs/Config.in
```kconfig
# vim: noexpandtab filetype=make
config BR2_PACKAGE_PYTHON_DOCUTILS_STUBS
	bool "python-docutils-stubs"
	select BR2_PACKAGE_PYTHON_DOCUTILS
	help
	  PEP 561 type stubs for docutils

	  https://github.com/tk0miya/docutils-stubs
```

## BR2_EXTERNAL/package/python-dpcontracts/Config.in
```kconfig
# vim: noexpandtab filetype=make
config BR2_PACKAGE_PYTHON_PYTHON_DPCONTRACTS
	bool "python-dpcontracts"
	depends on BR2_PACKAGE_PYTHON3
	help
	  A simple implementation of contracts for Python.

	  https://github.com/deadpixi/contracts
```

## BR2_EXTERNAL/package/python-dulwich/Config.in
```kconfig
# vim: noexpandtab filetype=make
config BR2_PACKAGE_PYTHON_PYTHON_DULWICH
	bool "python-dulwich"
	help
	  Python Git Library

	  https://www.dulwich.io/
```

## BR2_EXTERNAL/package/python-editdistance/Config.in
```kconfig
# vim: noexpandtab filetype=make
config BR2_PACKAGE_PYTHON_EDITDISTANCE
	bool "python-editdistance"
	depends on BR2_PACKAGE_PYTHON3
	help
	  Fast implementation of the edit distance(Levenshtein distance)

	  https://www.github.com/aflc/editdistance
```

## BR2_EXTERNAL/package/python-elementpath/Config.in
```kconfig
# vim: noexpandtab filetype=make
config BR2_PACKAGE_PYTHON_ELEMENTPATH
	bool "python-elementpath"
	depends on BR2_PACKAGE_PYTHON3
	help
	  XPath 1.0/2.0 parsers and selectors for ElementTree and lxml

	  https://github.com/sissaschool/elementpath
```

## BR2_EXTERNAL/package/python-eventlet/Config.in
```kconfig
# vim: noexpandtab filetype=make
config BR2_PACKAGE_PYTHON_EVENTLET
	bool "python-eventlet"
	select BR2_PACKAGE_PYTHON_DNSPYTHON # (>=1.15.0); 
	select BR2_PACKAGE_PYTHON_GREENLET # (>=0.3); 
	select BR2_PACKAGE_PYTHON_MONOTONIC # (>=1.4); 
	select BR2_PACKAGE_PYTHON_SIX # (>=1.10.0); 
	help
	  Highly concurrent networking library

	  http://eventlet.net
```

## BR2_EXTERNAL/package/python-execnet/Config.in
```kconfig
# vim: noexpandtab filetype=make
config BR2_PACKAGE_PYTHON_EXECNET
	bool "python-execnet"
	select BR2_PACKAGE_PYTHON_APIPKG
	select BR2_PACKAGE_PYTHON_PRE_COMMIT
	help
	  execnet: rapid multi-Python deployment

	  https://execnet.readthedocs.io/en/latest/
```

## BR2_EXTERNAL/package/python-fasteners/Config.in
```kconfig
# vim: noexpandtab filetype=make
config BR2_PACKAGE_PYTHON_FASTENERS
	bool "python-fasteners"
	select BR2_PACKAGE_PYTHON_SIX # ; 
	select BR2_PACKAGE_PYTHON_MONOTONIC # (>=0.1); 
	help
	  A python package that provides useful locks.

	  https://github.com/harlowja/fasteners
```

## BR2_EXTERNAL/package/python-fields/Config.in
```kconfig
# vim: noexpandtab filetype=make
config BR2_PACKAGE_PYTHON_PYTHON_FIELDS
	bool "python-fields"
	depends on BR2_PACKAGE_PYTHON3
	help
	  Container class boilerplate killer.

	  https://github.com/ionelmc/python-fields
```

## BR2_EXTERNAL/package/python-fixtures/Config.in
```kconfig
# vim: noexpandtab filetype=make
config BR2_PACKAGE_PYTHON_FIXTURES
	bool "python-fixtures"
	depends on BR2_PACKAGE_PYTHON3
	help
	  Fixtures, reusable state for writing clean tests and more.

	  https://launchpad.net/python-fixtures
```

## BR2_EXTERNAL/package/python-flake8-docstrings/Config.in
```kconfig
# vim: noexpandtab filetype=make
config BR2_PACKAGE_PYTHON_FLAKE8_DOCSTRINGS
	bool "python-flake8-docstrings"
	select BR2_PACKAGE_PYTHON_FLAKE8
	select BR2_PACKAGE_PYTHON_PYDOCSTYLE
	help
	  Extension for flake8 which uses pydocstyle to check docstrings

	  https://gitlab.com/pycqa/flake8-docstrings
```

## BR2_EXTERNAL/package/python-flake8-import-order/Config.in
```kconfig
# vim: noexpandtab filetype=make
config BR2_PACKAGE_PYTHON_PYTHON_FLAKE8_IMPORT_ORDER
	bool "python-flake8-import-order"
	select BR2_PACKAGE_PYTHON_PYCODESTYLE
	select BR2_PACKAGE_PYTHON_SETUPTOOLS
	select BR2_PACKAGE_PYTHON_ENUM34
	help
	  Flake8 and pylama plugin that checks the ordering of import statements.

	  https://github.com/PyCQA/flake8-import-order
```

## BR2_EXTERNAL/package/python-flake8/Config.in
```kconfig
# vim: noexpandtab filetype=make
config BR2_PACKAGE_PYTHON_FLAKE8
	bool "python-flake8"
	select BR2_PACKAGE_PYTHON_ENTRYPOINTS
	select BR2_PACKAGE_PYTHON_PYFLAKES
	select BR2_PACKAGE_PYTHON_PYCODESTYLE
	select BR2_PACKAGE_PYTHON_MCCABE
	select BR2_PACKAGE_PYTHON_CONFIGPARSER
	select BR2_PACKAGE_PYTHON_FUNCTOOLS32
	select BR2_PACKAGE_PYTHON_ENUM34
	select BR2_PACKAGE_PYTHON_TYPING
	help
	  the modular source code checker: pep8, pyflakes and co

	  https://gitlab.com/pycqa/flake8
```

## BR2_EXTERNAL/package/python-flaky/Config.in
```kconfig
# vim: noexpandtab filetype=make
config BR2_PACKAGE_PYTHON_PYTHON_FLAKY
	bool "python-flaky"
	help
	  Plugin for nose or pytest that automatically reruns flaky tests.

	  https://github.com/box/flaky
```

## BR2_EXTERNAL/package/python-freezegun/Config.in
```kconfig
# vim: noexpandtab filetype=make
config BR2_PACKAGE_PYTHON_PYTHON_FREEZEGUN
	bool "python-freezegun"
	select BR2_PACKAGE_PYTHON_SIX
	select BR2_PACKAGE_PYTHON_PYTHON_DATEUTIL
	help
	  Let your Python tests travel through time

	  https://github.com/spulec/freezegun
```

## BR2_EXTERNAL/package/python-func-timeout/Config.in
```kconfig
# vim: noexpandtab filetype=make
config BR2_PACKAGE_PYTHON_PYTHON_FUNC_TIMEOUT
	bool "python-func-timeout"
	depends on BR2_PACKAGE_PYTHON
	help
	  Python module which allows you to specify timeouts when calling any existing function. Also provides support for stoppable-threads

	  https://github.com/kata198/func_timeout
```

## BR2_EXTERNAL/package/python-gmpy/Config.in
```kconfig
# vim: noexpandtab filetype=make
config BR2_PACKAGE_PYTHON_GMPY
	bool "python-gmpy"
	help
	  GMP or MPIR interface to Python 2.4+ and 3.x

	  http://code.google.com/p/gmpy/
```

## BR2_EXTERNAL/package/python-gmpy2/Config.in
```kconfig
# vim: noexpandtab filetype=make
config BR2_PACKAGE_PYTHON_GMPY2
	bool "python-gmpy2"
	help
	  GMP/MPIR, MPFR, and MPC interface to Python 2.6+ and 3.x

	  https://github.com/aleaxit/gmpy
```

## BR2_EXTERNAL/package/python-gnureadline/Config.in
```kconfig
# vim: noexpandtab filetype=make
config BR2_PACKAGE_PYTHON_GNUREADLINE
	bool "python-gnureadline"
	help
	  The standard Python readline extension statically linked against the GNU readline library.

	  http://github.com/ludwigschwardt/python-gnureadline
```

## BR2_EXTERNAL/package/python-greenlet/Config.in
```kconfig
# vim: noexpandtab filetype=make
config BR2_PACKAGE_PYTHON_PYTHON_GREENLET
	bool "python-greenlet"
	help
	  Lightweight in-process concurrent programming

	  https://github.com/python-greenlet/greenlet
```

## BR2_EXTERNAL/package/python-hacking/Config.in
```kconfig
# vim: noexpandtab filetype=make
config BR2_PACKAGE_PYTHON_HACKING
	bool "python-hacking"
	depends on BR2_PACKAGE_PYTHON3
	select BR2_PACKAGE_PYTHON_FLAKE8
	select BR2_PACKAGE_PYTHON_SIX
	select BR2_PACKAGE_PYTHON_FLAKE8_DOCSTRINGS
	help
	  OpenStack Hacking Guideline Enforcement

	  https://docs.openstack.org/hacking/latest/
```

## BR2_EXTERNAL/package/python-hunter/Config.in
```kconfig
# vim: noexpandtab filetype=make
config BR2_PACKAGE_PYTHON_PYTHON_HUNTER
	bool "python-hunter"
	depends on BR2_PACKAGE_PYTHON3
	select BR2_PACKAGE_PYTHON_COLORAMA
	select BR2_PACKAGE_PYTHON_MANHOLE
	help
	  Hunter is a flexible code tracing toolkit.

	  https://github.com/ionelmc/python-hunter
```

## BR2_EXTERNAL/package/python-hypothesis/Config.in
```kconfig
# vim: noexpandtab filetype=make
config BR2_PACKAGE_PYTHON_HYPOTHESIS
	bool "python-hypothesis"
	depends on BR2_PACKAGE_PYTHON3
	select BR2_PACKAGE_PYTHON_ATTRS
	select BR2_PACKAGE_PYTHON_SORTEDCONTAINERS
	select BR2_PACKAGE_PYTHON_DJANGO
	select BR2_PACKAGE_PYTHON_DPCONTRACTS
	select BR2_PACKAGE_PYTHON_LARK_PARSER
	select BR2_PACKAGE_PYTHON_NUMPY
	select BR2_PACKAGE_PYTHON_PANDAS
	select BR2_PACKAGE_PYTHON_PYTEST
	select BR2_PACKAGE_PYTHON_DATEUTIL
	select BR2_PACKAGE_PYTHON_PYTZ
	select BR2_PACKAGE_PYTHON_DATEUTIL
	select BR2_PACKAGE_PYTHON_PYTZ
	select BR2_PACKAGE_PYTHON_DJANGO
	select BR2_PACKAGE_PYTHON_DPCONTRACTS
	select BR2_PACKAGE_PYTHON_LARK_PARSER
	select BR2_PACKAGE_PYTHON_NUMPY
	select BR2_PACKAGE_PYTHON_PANDAS
	select BR2_PACKAGE_PYTHON_PYTEST
	select BR2_PACKAGE_PYTHON_PYTZ
	help
	  A library for property-based testing

	  https://github.com/HypothesisWorks/hypothesis/tree/master/hypothesis-python
```

## BR2_EXTERNAL/package/python-identify/Config.in
```kconfig
# vim: noexpandtab filetype=make
config BR2_PACKAGE_PYTHON_IDENTIFY
	bool "python-identify"
	select BR2_PACKAGE_PYTHON_EDITDISTANCE
	help
	  File identification library for Python

	  https://github.com/chriskuehl/identify
```

## BR2_EXTERNAL/package/python-imagesize/Config.in
```kconfig
# vim: noexpandtab filetype=make
config BR2_PACKAGE_PYTHON_PYTHON_IMAGESIZE
	bool "python-imagesize"
	help
	  Getting image size from png/jpeg/jpeg2000/gif file

	  https://github.com/shibukawa/imagesize_py
```
