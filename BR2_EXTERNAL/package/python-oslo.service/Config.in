## BR2_EXTERNAL/package/python-oslo.service/Config.in
```kconfig
# vim: noexpandtab filetype=make
config BR2_PACKAGE_PYTHON_OSLOSERVICE
	bool "python-oslo.service"
	depends on BR2_PACKAGE_PYTHON3
	select BR2_PACKAGE_PYTHON_WEBOB # (>=1.7.1); 
	select BR2_PACKAGE_PYTHON_DEBTCOLLECTOR # (>=1.2.0); 
	select BR2_PACKAGE_PYTHON_EVENTLET # (!=0.23.0,!=0.25.0,>=0.22.0); 
	select BR2_PACKAGE_PYTHON_FIXTURES # (>=3.0.0); 
	select BR2_PACKAGE_PYTHON_GREENLET # (>=0.4.10); 
	select BR2_PACKAGE_PYTHON_OSLOUTILS # (>=3.40.2); 
	select BR2_PACKAGE_PYTHON_OSLOCONCURRENCY # (>=3.25.0); 
	select BR2_PACKAGE_PYTHON_OSLOCONFIG # (>=5.1.0); 
	select BR2_PACKAGE_PYTHON_OSLOLOG # (>=3.36.0); 
	select BR2_PACKAGE_PYTHON_SIX # (>=1.10.0); 
	select BR2_PACKAGE_PYTHON_OSLOI18N # (>=3.15.3); 
	select BR2_PACKAGE_PYTHON_PASTEDEPLOY # (>=1.5.0); 
	select BR2_PACKAGE_PYTHON_ROUTES # (>=2.3.1); 
	select BR2_PACKAGE_PYTHON_PASTE # (>=2.0.2); 
	select BR2_PACKAGE_PYTHON_YAPPI # (>=1.0); 
	help
	  oslo.service library

	  https://docs.openstack.org/oslo.service/latest/
```

## BR2_EXTERNAL/package/python-oslo.utils/Config.in
```kconfig
# vim: noexpandtab filetype=make
config BR2_PACKAGE_PYTHON_OSLOUTILS
	bool "python-oslo.utils"
	depends on BR2_PACKAGE_PYTHON3
	select BR2_PACKAGE_PYTHON_PBR # (!=2.1.0,>=2.0.0); 
	select BR2_PACKAGE_PYTHON_SIX # (>=1.10.0); 
	select BR2_PACKAGE_PYTHON_ISO8601 # (>=0.1.11); 
	select BR2_PACKAGE_PYTHON_OSLOI18N # (>=3.15.3); 
	select BR2_PACKAGE_PYTHON_PYTZ # (>=2013.6); 
	select BR2_PACKAGE_PYTHON_NETADDR # (>=0.7.18); 
	select BR2_PACKAGE_PYTHON_NETIFACES # (>=0.10.4); 
	select BR2_PACKAGE_PYTHON_DEBTCOLLECTOR # (>=1.2.0); 
	select BR2_PACKAGE_PYTHON_PYPARSING # (>=2.1.0); 
	help
	  Oslo Utility library

	  https://docs.openstack.org/oslo.utils/latest/
```

## BR2_EXTERNAL/package/python-osloconfig/Config.in
```kconfig
# vim: noexpandtab filetype=make
config BR2_PACKAGE_PYTHON_OSLOCONFIG
	bool "python-oslo.config"
	depends on BR2_PACKAGE_PYTHON3
	select BR2_PACKAGE_PYTHON_DEBTCOLLECTOR
	select BR2_PACKAGE_PYTHON_NETADDR
	select BR2_PACKAGE_PYTHON_STEVEDORE
	select BR2_PACKAGE_PYTHON_OSLOI18N
	select BR2_PACKAGE_PYTHON_RFC3986
	select BR2_PACKAGE_PYTHON_PYYAML
	select BR2_PACKAGE_PYTHON_REQUESTS
	help
	  The Oslo configuration API supports parsing command line arguments and .ini style configuration files.

	  https://docs.openstack.org/oslo.config/latest/
```

## BR2_EXTERNAL/package/python-oslolog/Config.in
```kconfig
# vim: noexpandtab filetype=make
config BR2_PACKAGE_PYTHON_OSLOLOG
	bool "python-oslo.log"
	depends on BR2_PACKAGE_PYTHON3
	select BR2_PACKAGE_PYTHON_PBR
	select BR2_PACKAGE_PYTHON_SIX
	select BR2_PACKAGE_PYTHON_OSLOCONFIG
	select BR2_PACKAGE_PYTHON_OSLOCONTEXT
	select BR2_PACKAGE_PYTHON_OSLOI18N
	select BR2_PACKAGE_PYTHON_OSLOUTILS
	select BR2_PACKAGE_PYTHON_OSLOSERIALIZATION
	select BR2_PACKAGE_PYTHON_DEBTCOLLECTOR
	select BR2_PACKAGE_PYTHON_PYINOTIFY
	select BR2_PACKAGE_PYTHON_PYTHON_DATEUTIL
	select BR2_PACKAGE_PYTHON_MONOTONIC
	help
	  The oslo.log (logging) configuration library provides standardized configuration for all openstack projects.
	  It also provides custom formatters, handlers and support for context specific logging (like resource id's etc).

	  https://docs.openstack.org/oslo.log/latest
```

## BR2_EXTERNAL/package/python-osloserialization/Config.in
```kconfig
# vim: noexpandtab filetype=make
config BR2_PACKAGE_PYTHON_OSLOSERIALIZATION
	bool "python-oslo.serialization"
	depends on BR2_PACKAGE_PYTHON3
	select BR2_PACKAGE_PYTHON_PBR
	BR2_PACKAGE_PYTHON_SIX
	BR2_PACKAGE_PYTHON_MSGPACK
	BR2_PACKAGE_PYTHON_OSLOUTILS
	BR2_PACKAGE_PYTHON_PYTZ
	BR2_PACKAGE_PYTHON_PYYAML
	BR2_PACKAGE_PYTHON_DEBTCOLLECTOR
	help
	  The oslo.serialization library provides support for representing objects
	  in transmittable and storable formats, such as Base64, JSON and MessagePack.

	  https://docs.openstack.org/oslo.serialization/latest/
```

## BR2_EXTERNAL/package/python-osloservice/Config.in
```kconfig
# vim: noexpandtab filetype=make
config BR2_PACKAGE_PYTHON_OSLOSERVICE
	bool "python-oslo.service"
	depends on BR2_PACKAGE_PYTHON3
	select BR2_PACKAGE_PYTHON_WEBOB
	select BR2_PACKAGE_PYTHON_DEBTCOLLECTOR
	select BR2_PACKAGE_PYTHON_EVENTLET
	select BR2_PACKAGE_PYTHON_FIXTURES
	select BR2_PACKAGE_PYTHON_GREENLET
	select BR2_PACKAGE_PYTHON_OSLOUTILS
	select BR2_PACKAGE_PYTHON_OSLOCONCURRENCY
	select BR2_PACKAGE_PYTHON_OSLOCONFIG
	select BR2_PACKAGE_PYTHON_OSLOLOG
	select BR2_PACKAGE_PYTHON_SIX
	select BR2_PACKAGE_PYTHON_OSLOI18N
	select BR2_PACKAGE_PYTHON_PASTEDEPLOY
	select BR2_PACKAGE_PYTHON_ROUTES
	select BR2_PACKAGE_PYTHON_PASTE
	select BR2_PACKAGE_PYTHON_YAPPI
	help
		oslo.service provides a framework for defining new long-running services using the patterns established by other OpenStack applications. It also includes utilities long-running applications might need for working with SSL or WSGI, performing periodic operations, interacting with systemd, etc.
		
		https://docs.openstack.org/oslo.service/latest/
```

## BR2_EXTERNAL/package/python-oslotest/Config.in
```kconfig
# vim: noexpandtab filetype=make
config BR2_PACKAGE_PYTHON_PYTHON_OSLOTEST
	bool "python-oslotest"
	depends on BR2_PACKAGE_PYTHON3
	select BR2_PACKAGE_PYTHON_FIXTURES
	select BR2_PACKAGE_PYTHON_PYTHON_SUBUNIT
	select BR2_PACKAGE_PYTHON_SIX
	select BR2_PACKAGE_PYTHON_TESTTOOLS
	help
	  Oslo test framework

	  https://docs.openstack.org/oslotest/latest/
```

## BR2_EXTERNAL/package/python-osloutils/Config.in
```kconfig
# vim: noexpandtab filetype=make
config BR2_PACKAGE_PYTHON_OSLOUTILS
	bool "python-oslo.utils"
	depends on BR2_PACKAGE_PYTHON3
	select BR2_PACKAGE_PYTHON_PBR
	select BR2_PACKAGE_PYTHON_SIX
	select BR2_PACKAGE_PYTHON_ISO8601
	select BR2_PACKAGE_PYTHON_OSLOI18N
	select BR2_PACKAGE_PYTHON_PYTZ
	select BR2_PACKAGE_PYTHON_NETADDR
	select BR2_PACKAGE_PYTHON_NETIFACES
	select BR2_PACKAGE_PYTHON_DEBTCOLLECTOR
	select BR2_PACKAGE_PYTHON_PYPARSING
	help
	  The oslo.utils library provides support for common utility type functions, such as encoding, exception handling, string manipulation, and time handling
	  
	  https://docs.openstack.org/oslo.utils/latest/
```

## BR2_EXTERNAL/package/python-packaging/Config.in
```kconfig
# vim: noexpandtab filetype=make
config BR2_PACKAGE_PYTHON_PACKAGING
	bool "python-packaging"
	select BR2_PACKAGE_PYTHON_PYPARSING
	select BR2_PACKAGE_PYTHON_SIX
	help
	  Core utilities for Python packages

	  https://github.com/pypa/packaging
```

## BR2_EXTERNAL/package/python-pandas/Config.in
```kconfig
# vim: noexpandtab filetype=make
config BR2_PACKAGE_PYTHON_PANDAS
	bool "python-pandas"
	depends on BR2_PACKAGE_PYTHON3
	select BR2_PACKAGE_PYTHON_DATEUTIL
	select BR2_PACKAGE_PYTHON_PYTZ
	select BR2_PACKAGE_PYTHON_NUMPY
	help
	  Powerful data structures for data analysis, time series, and statistics

	  https://pandas.pydata.org
```

## BR2_EXTERNAL/package/python-paste/Config.in
```kconfig
# vim: noexpandtab filetype=make
config BR2_PACKAGE_PYTHON_PASTE
	bool "python-paste"
	depends on BR2_PACKAGE_PYTHON3
	select BR2_PACKAGE_PYTHON_SIX # (>=1.4.0); 
	select BR2_PACKAGE_PYTHON_PYTHON_OPENID # ; extra == 'openid'
	help
	  Tools for using a Web Server Gateway Interface stack

	  https://pythonpaste.readthedocs.io/
```

## BR2_EXTERNAL/package/python-pastedeploy/Config.in
```kconfig
# vim: noexpandtab filetype=make
config BR2_PACKAGE_PYTHON_PASTEDEPLOY
	bool "python-pastedeploy"
	help
	  Load, configure, and compose WSGI applications and servers

	  https://pylonsproject.org/
```

## BR2_EXTERNAL/package/python-path.py/Config.in
```kconfig
# vim: noexpandtab filetype=make
config BR2_PACKAGE_PYTHON_PYTHON_PATHPY
	bool "python-path.py"
	depends on BR2_PACKAGE_PYTHON3
	select BR2_PACKAGE_PYTHON_PATH
	select BR2_PACKAGE_PYTHON_SPHINX
	select BR2_PACKAGE_PYTHON_JARACOPACKAGING
	select BR2_PACKAGE_PYTHON_RSTLINKER
	select BR2_PACKAGE_PYTHON_PYTEST
	select BR2_PACKAGE_PYTHON_PYTEST_CHECKDOCS
	select BR2_PACKAGE_PYTHON_PYTEST_FLAKE8
	select BR2_PACKAGE_PYTHON_PYTEST_BLACK_MULTIPY
	select BR2_PACKAGE_PYTHON_PYTEST_COV
	select BR2_PACKAGE_PYTHON_APPDIRS
	select BR2_PACKAGE_PYTHON_PACKAGING
	select BR2_PACKAGE_PYTHON_PYGMENTS
	help
	  A module wrapper for os.path

	  https://github.com/jaraco/path
```

## BR2_EXTERNAL/package/python-path/Config.in
```kconfig
# vim: noexpandtab filetype=make
config BR2_PACKAGE_PYTHON_PATH
	bool "python-path"
	depends on BR2_PACKAGE_PYTHON3
	help
	  A module wrapper for os.path

	  https://github.com/jaraco/path
```

## BR2_EXTERNAL/package/python-pbr/Config.in
```kconfig
# vim: noexpandtab filetype=make
config BR2_PACKAGE_PYTHON_PBR
	bool "python-pbr"
	select BR2_PACKAGE_PYTHON_WHEEL
	select BR2_PACKAGE_PYTHON_FIXTURES
	select BR2_PACKAGE_PYTHON_HACKING
	select BR2_PACKAGE_PYTHON_MOCK
	select BR2_PACKAGE_PYTHON_SIX
	select BR2_PACKAGE_PYTHON_STESTR
	select BR2_PACKAGE_PYTHON_TESTRESOURCES
	select BR2_PACKAGE_PYTHON_TESTSCENARIOS
	select BR2_PACKAGE_PYTHON_TESTTOOLS
	select BR2_PACKAGE_PYTHON_VIRTUALENV
	select BR2_PACKAGE_PYTHON_COVERAGE
	select BR2_PACKAGE_PYTHON_SPHINX
	select BR2_PACKAGE_PYTHON_TESTREPOSITORY
	help
	  PBR is a library that injects some useful and sensible default behaviors
	  into your setuptools run. It started off life as the chunks of code that
	  were copied between all of the OpenStack-projects
	  
	  https://docs.openstack.org/pbr/latest/
```

## BR2_EXTERNAL/package/python-pifpaf/Config.in
```kconfig
# vim: noexpandtab filetype=make
config BR2_PACKAGE_PYTHON_PIFPAF
	bool "python-pifpaf"
	select BR2_PACKAGE_PYTHON_DAIQUIRI
	select BR2_PACKAGE_PYTHON_CLICK
	select BR2_PACKAGE_PYTHON_PBR
	select BR2_PACKAGE_PYTHON_JINJA2
	select BR2_PACKAGE_PYTHON_SIX
	select BR2_PACKAGE_PYTHON_FIXTURES
	select BR2_PACKAGE_PYTHON_PSUTIL
	select BR2_PACKAGE_PYTHON_XATTR
	select BR2_PACKAGE_PYTHON_UWSGI
	help
	  Suite of tools and fixtures to manage daemons for testing

	  https://github.com/jd/pifpaf
```

## BR2_EXTERNAL/package/python-pint/Config.in
```kconfig
# vim: noexpandtab filetype=make
config BR2_PACKAGE_PYTHON_PINT
	bool "python-pint"
	depends on BR2_PACKAGE_PYTHON3
	select BR2_PACKAGE_PYTHON_SETUPTOOLS # ; 
	help
	  Physical quantities module

	  https://github.com/hgrecco/pint
```

## BR2_EXTERNAL/package/python-pkginfo/Config.in
```kconfig
# vim: noexpandtab filetype=make
config BR2_PACKAGE_PYTHON_PKGINFO
	bool "python-pkginfo"
	select BR2_PACKAGE_PYTHON_NOSE
	select BR2_PACKAGE_PYTHON_COVERAGE
	help
	  Query metadatdata from sdists / bdists / installed packages.

	  https://code.launchpad.net/~tseaver/pkginfo/trunk
```

## BR2_EXTERNAL/package/python-pluggy/Config.in
```kconfig
# vim: noexpandtab filetype=make
config BR2_PACKAGE_PYTHON_PYTHON_PLUGGY
	bool "python-pluggy"
	select BR2_PACKAGE_PYTHON_IMPORTLIB_METADATA
	select BR2_PACKAGE_PYTHON_PRE_COMMIT
	select BR2_PACKAGE_PYTHON_TOX
	help
	  plugin and hook calling mechanisms for python

	  https://github.com/pytest-dev/pluggy
```

## BR2_EXTERNAL/package/python-pre-commit/Config.in
```kconfig
# vim: noexpandtab filetype=make
config BR2_PACKAGE_PYTHON_PRE_COMMIT
	bool "python-pre-commit"
	depends on BR2_PACKAGE_PYTHON3
	select BR2_PACKAGE_PYTHON_CFGV
	select BR2_PACKAGE_PYTHON_IDENTIFY
	select BR2_PACKAGE_PYTHON_NODEENV
	select BR2_PACKAGE_PYTHON_PYYAML
	select BR2_PACKAGE_PYTHON_TOML
	select BR2_PACKAGE_PYTHON_VIRTUALENV
	select BR2_PACKAGE_PYTHON_IMPORTLIB_RESOURCES
	select BR2_PACKAGE_PYTHON_IMPORTLIB_METADATA
	help
	  A framework for managing and maintaining multi-language pre-commit hooks.

	  https://github.com/pre-commit/pre-commit
```

## BR2_EXTERNAL/package/python-prettytable/Config.in
```kconfig
# vim: noexpandtab filetype=make
config BR2_PACKAGE_PYTHON_PRETTYTABLE
	bool "python-prettytable"
	depends on BR2_PACKAGE_PYTHON3
	help
	  A simple Python library for easily displaying tabular data in a visually appealing ASCII table format.

	  http://code.google.com/p/prettytable/
```

## BR2_EXTERNAL/package/python-process-tests/Config.in
```kconfig
# vim: noexpandtab filetype=make
config BR2_PACKAGE_PYTHON_PYTHON_PROCESS_TESTS
	bool "python-process-tests"
	depends on BR2_PACKAGE_PYTHON3
	help
	  Tools for testing processes

	  https://github.com/ionelmc/python-process-tests
```

## BR2_EXTERNAL/package/python-proselint/Config.in
```kconfig
# vim: noexpandtab filetype=make
config BR2_PACKAGE_PYTHON_PYTHON_PROSELINT
	bool "python-proselint"
	depends on BR2_PACKAGE_PYTHON
	select BR2_PACKAGE_PYTHON_CLICK
	select BR2_PACKAGE_PYTHON_FUTURE
	select BR2_PACKAGE_PYTHON_SIX
	help
	  A linter for prose.

	  http://github.com/amperser/proselint
```

## BR2_EXTERNAL/package/python-pycodestyle/Config.in
```kconfig
# vim: noexpandtab filetype=make
config BR2_PACKAGE_PYTHON_PYCODESTYLE
	bool "python-pycodestyle"
	help
	  Python style guide checker

	  https://pycodestyle.readthedocs.io/
```

## BR2_EXTERNAL/package/python-pydocstyle/Config.in
```kconfig
# vim: noexpandtab filetype=make
config BR2_PACKAGE_PYTHON_PYDOCSTYLE
	bool "python-pydocstyle"
	depends on BR2_PACKAGE_PYTHON3
	select BR2_PACKAGE_PYTHON_SNOWBALLSTEMMER
	help
	  Python docstring style checker

	  https://github.com/PyCQA/pydocstyle/
```
