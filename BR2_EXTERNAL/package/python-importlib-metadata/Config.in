## BR2_EXTERNAL/package/python-importlib-metadata/Config.in
```kconfig
# vim: noexpandtab filetype=make
config BR2_PACKAGE_PYTHON_PYTHON_IMPORTLIB_METADATA
	bool "python-importlib-metadata"
	select BR2_PACKAGE_PYTHON_ZIPP
	select BR2_PACKAGE_PYTHON_PATHLIB2
	select BR2_PACKAGE_PYTHON_CONTEXTLIB2
	select BR2_PACKAGE_PYTHON_CONFIGPARSER
	select BR2_PACKAGE_PYTHON_SPHINX
	select BR2_PACKAGE_PYTHON_RSTLINKER
	select BR2_PACKAGE_PYTHON_PACKAGING
	select BR2_PACKAGE_PYTHON_IMPORTLIB_RESOURCES
	help
	  Read metadata from Python packages

	  http://importlib-metadata.readthedocs.io/
```

## BR2_EXTERNAL/package/python-importlib-resources/Config.in
```kconfig
# vim: noexpandtab filetype=make
config BR2_PACKAGE_PYTHON_PYTHON_IMPORTLIB_RESOURCES
	bool "python-importlib-resources"
	depends on BR2_PACKAGE_PYTHON3
	select BR2_PACKAGE_PYTHON_PATHLIB2
	select BR2_PACKAGE_PYTHON_CONTEXTLIB2
	select BR2_PACKAGE_PYTHON_SINGLEDISPATCH
	select BR2_PACKAGE_PYTHON_TYPING
	select BR2_PACKAGE_PYTHON_ZIPP
	select BR2_PACKAGE_PYTHON_IMPORTLIB_METADATA
	select BR2_PACKAGE_PYTHON_SPHINX
	select BR2_PACKAGE_PYTHON_RSTLINKER
	select BR2_PACKAGE_PYTHON_JARACOPACKAGING
	help
	  Read resources from Python packages

	  http://importlib-resources.readthedocs.io/
```

## BR2_EXTERNAL/package/python-invoke/Config.in
```kconfig
# vim: noexpandtab filetype=make
config BR2_PACKAGE_PYTHON_PYTHON_INVOKE
	bool "python-invoke"
	help
	  Pythonic task execution

	  http://docs.pyinvoke.org
```

## BR2_EXTERNAL/package/python-ironic-lib/Config.in
```kconfig
# vim: noexpandtab filetype=make
config BR2_PACKAGE_PYTHON_IRONIC_LIB
	bool "python-ironic-lib"
	depends on BR2_PACKAGE_PYTHON3
	select BR2_PACKAGE_PYTHON_PBR # (!=2.1.0,>=2.0.0); 
	select BR2_PACKAGE_PYTHON_OSLOCONCURRENCY # (>=3.26.0); 
	select BR2_PACKAGE_PYTHON_OSLOCONFIG # (>=5.2.0); 
	select BR2_PACKAGE_PYTHON_OSLOI18N # (>=3.15.3); 
	select BR2_PACKAGE_PYTHON_OSLOSERIALIZATION # (!=2.19.1,>=2.18.0); 
	select BR2_PACKAGE_PYTHON_OSLOSERVICE # (!=1.28.1,>=1.24.0); 
	select BR2_PACKAGE_PYTHON_OSLOUTILS # (>=3.33.0); 
	select BR2_PACKAGE_PYTHON_REQUESTS # (>=2.14.2); 
	select BR2_PACKAGE_PYTHON_OSLOLOG # (>=3.36.0); 
	select BR2_PACKAGE_PYTHON_ZEROCONF # (>=0.24.0); (python_version>='3.0')
	help
	  Ironic common library

	  https://docs.openstack.org/ironic-lib/
```

## BR2_EXTERNAL/package/python-ironic-python-agent/Config.in
```kconfig
# vim: noexpandtab filetype=make
config BR2_PACKAGE_PYTHON_IRONIC_PYTHON_AGENT
	bool "python-ironic-python-agent"
	depends on BR2_PACKAGE_PYTHON3
	select BR2_PACKAGE_PYTHON_PBR # (!=2.1.0,>=2.0.0); 
	select BR2_PACKAGE_PYTHON_EVENTLET # (!=0.18.3,!=0.20.1,>=0.18.2); 
	select BR2_PACKAGE_PYTHON_NETIFACES # (>=0.10.4); 
	select BR2_PACKAGE_PYTHON_OSLOCONFIG # (>=5.2.0); 
	select BR2_PACKAGE_PYTHON_OSLOCONCURRENCY # (>=3.26.0); 
	select BR2_PACKAGE_PYTHON_OSLOLOG # (>=3.36.0); 
	select BR2_PACKAGE_PYTHON_OSLOSERIALIZATION # (!=2.19.1,>=2.18.0); 
	select BR2_PACKAGE_PYTHON_OSLOSERVICE # (!=1.28.1,>=1.24.0); 
	select BR2_PACKAGE_PYTHON_OSLOUTILS # (>=3.33.0); 
	select BR2_PACKAGE_PYTHON_PINT # (>=0.5); 
	select BR2_PACKAGE_PYTHON_PSUTIL # (>=3.2.2); 
	select BR2_PACKAGE_PYTHON_PYUDEV # (>=0.18); 
	select BR2_PACKAGE_PYTHON_REQUESTS # (>=2.14.2); 
	select BR2_PACKAGE_PYTHON_RTSLIB_FB # (>=2.1.65); 
	select BR2_PACKAGE_PYTHON_STEVEDORE # (>=1.20.0); 
	select BR2_PACKAGE_PYTHON_IRONIC_LIB # (>=2.17.0); 
	select BR2_PACKAGE_PYTHON_WERKZEUG # (>=0.15.0); 
	help
	  Ironic Python Agent Ramdisk

	  https://docs.openstack.org/ironic-python-agent/
```

## BR2_EXTERNAL/package/python-jaraco.itertools/Config.in
```kconfig
# vim: noexpandtab filetype=make
config BR2_PACKAGE_PYTHON_PYTHON_JARACOITERTOOLS
	bool "python-jaraco.itertools"
	depends on BR2_PACKAGE_PYTHON3
	select BR2_PACKAGE_PYTHON_MORE_ITERTOOLS
	select BR2_PACKAGE_PYTHON_INFLECT
	select BR2_PACKAGE_PYTHON_SPHINX
	select BR2_PACKAGE_PYTHON_JARACOPACKAGING
	select BR2_PACKAGE_PYTHON_RSTLINKER
	select BR2_PACKAGE_PYTHON_PYTEST
	select BR2_PACKAGE_PYTHON_PYTEST_CHECKDOCS
	select BR2_PACKAGE_PYTHON_PYTEST_FLAKE8
	select BR2_PACKAGE_PYTHON_PYTEST_BLACK_MULTIPY
	select BR2_PACKAGE_PYTHON_PYTEST_COV
	help
	  jaraco.itertools

	  https://github.com/jaraco/jaraco.itertools
```

## BR2_EXTERNAL/package/python-jaraco.packaging/Config.in
```kconfig
# vim: noexpandtab filetype=make
config BR2_PACKAGE_PYTHON_PYTHON_JARACOPACKAGING
	bool "python-jaraco.packaging"
	depends on BR2_PACKAGE_PYTHON3
	select BR2_PACKAGE_PYTHON_SIX
	select BR2_PACKAGE_PYTHON_SETUPTOOLS
	select BR2_PACKAGE_PYTHON_IMPORTLIB_METADATA
	select BR2_PACKAGE_PYTHON_SPHINX
	select BR2_PACKAGE_PYTHON_JARACOPACKAGING
	select BR2_PACKAGE_PYTHON_RSTLINKER
	select BR2_PACKAGE_PYTHON_PYTEST
	select BR2_PACKAGE_PYTHON_PYTEST_CHECKDOCS
	select BR2_PACKAGE_PYTHON_PYTEST_FLAKE8
	select BR2_PACKAGE_PYTHON_PYTEST_BLACK_MULTIPY
	select BR2_PACKAGE_PYTHON_PYTEST_COV
	help
	  tools to supplement packaging Python releases

	  https://github.com/jaraco/jaraco.packaging
```

## BR2_EXTERNAL/package/python-lark-parser/Config.in
```kconfig
# vim: noexpandtab filetype=make
config BR2_PACKAGE_PYTHON_PYTHON_LARK_PARSER
	bool "python-lark-parser"
	depends on BR2_PACKAGE_PYTHON3
	help
	  a modern parsing library

	  https://github.com/erezsh/lark
```

## BR2_EXTERNAL/package/python-manhole/Config.in
```kconfig
# vim: noexpandtab filetype=make
config BR2_PACKAGE_PYTHON_PYTHON_MANHOLE
	bool "python-manhole"
	depends on BR2_PACKAGE_PYTHON3
	help
	  Manhole is in-process service that will accept unix domain socket connections and present the

	  https://github.com/ionelmc/python-manhole
```

## BR2_EXTERNAL/package/python-mccabe/Config.in
```kconfig
# vim: noexpandtab filetype=make
config BR2_PACKAGE_PYTHON_MCCABE
	bool "python-mccabe"
	help
	  McCabe checker, plugin for flake8

	  https://github.com/pycqa/mccabe
```

## BR2_EXTERNAL/package/python-mock/Config.in
```kconfig
# vim: noexpandtab filetype=make
config BR2_PACKAGE_PYTHON_MOCK
	bool "python-mock"
	select BR2_PACKAGE_PYTHON_TWINE
	select BR2_PACKAGE_PYTHON_WHEEL
	select BR2_PACKAGE_PYTHON_BLURB
	select BR2_PACKAGE_PYTHON_SPHINX
	select BR2_PACKAGE_PYTHON_PYTEST
	select BR2_PACKAGE_PYTHON_PYTEST_COV
	help
	  Rolling backport of unittest.mock for all Pythons

	  http://mock.readthedocs.org/en/latest/
```

## BR2_EXTERNAL/package/python-monotonic/Config.in
```kconfig
# vim: noexpandtab filetype=make
config BR2_PACKAGE_PYTHON_PYTHON_MONOTONIC
	bool "python-monotonic"
	help
	  An implementation of time.monotonic() for Python 2 & < 3.3

	  https://github.com/atdt/monotonic
```

## BR2_EXTERNAL/package/python-mypy-extensions/Config.in
```kconfig
# vim: noexpandtab filetype=make
config BR2_PACKAGE_PYTHON_MYPY_EXTENSIONS
	bool "python-mypy-extensions"
	select BR2_PACKAGE_PYTHON_TYPING
	help
	  Experimental type system extensions for programs checked with the mypy typechecker.

	  https://github.com/python/mypy_extensions
```

## BR2_EXTERNAL/package/python-mypy/Config.in
```kconfig
# vim: noexpandtab filetype=make
config BR2_PACKAGE_PYTHON_MYPY
	bool "python-mypy"
	depends on BR2_PACKAGE_PYTHON3
	select BR2_PACKAGE_PYTHON_TYPED_AST
	select BR2_PACKAGE_PYTHON_TYPING_EXTENSIONS
	select BR2_PACKAGE_PYTHON_MYPY_EXTENSIONS
	select BR2_PACKAGE_PYTHON_PSUTIL
	help
	  Optional static typing for Python

	  http://www.mypy-lang.org/
```

## BR2_EXTERNAL/package/python-nodeenv/Config.in
```kconfig
# vim: noexpandtab filetype=make
config BR2_PACKAGE_PYTHON_PYTHON_NODEENV
	bool "python-nodeenv"
	help
	  Node.js virtual environment builder

	  https://github.com/ekalinin/nodeenv
```

## BR2_EXTERNAL/package/python-nose/Config.in
```kconfig
# vim: noexpandtab filetype=make
config BR2_PACKAGE_PYTHON_PYTHON_NOSE
	bool "python-nose"
	depends on BR2_PACKAGE_PYTHON3
	help
	  nose extends unittest to make testing easier

	  http://readthedocs.org/docs/nose/
```

## BR2_EXTERNAL/package/python-openstackdocstheme/Config.in
```kconfig
# vim: noexpandtab filetype=make
config BR2_PACKAGE_PYTHON_OPENSTACKDOCSTHEME
	bool "python-openstackdocstheme"
	depends on BR2_PACKAGE_PYTHON3
	select BR2_PACKAGE_PYTHON_PBR
	select BR2_PACKAGE_PYTHON_DULWICH
	help
	  OpenStack Docs Theme

	  https://docs.openstack.org/openstackdocstheme/latest/
```

## BR2_EXTERNAL/package/python-os-testr/Config.in
```kconfig
# vim: noexpandtab filetype=make
config BR2_PACKAGE_PYTHON_PYTHON_OS_TESTR
	bool "python-os-testr"
	depends on BR2_PACKAGE_PYTHON3
	select BR2_PACKAGE_PYTHON_PBR
	select BR2_PACKAGE_PYTHON_STESTR
	select BR2_PACKAGE_PYTHON_PYTHON_SUBUNIT
	select BR2_PACKAGE_PYTHON_TESTTOOLS
	help
	  A testr wrapper to provide functionality for OpenStack projects

	  https://docs.openstack.org/os-testr/latest/
```

## BR2_EXTERNAL/package/python-oslo.concurrency/Config.in
```kconfig
# vim: noexpandtab filetype=make
config BR2_PACKAGE_PYTHON_OSLOCONCURRENCY
	bool "python-oslo.concurrency"
	depends on BR2_PACKAGE_PYTHON3
	select BR2_PACKAGE_PYTHON_PBR # (!=2.1.0,>=2.0.0); 
	select BR2_PACKAGE_PYTHON_OSLOCONFIG # (>=5.2.0); 
	select BR2_PACKAGE_PYTHON_OSLOI18N # (>=3.15.3); 
	select BR2_PACKAGE_PYTHON_OSLOUTILS # (>=3.33.0); 
	select BR2_PACKAGE_PYTHON_SIX # (>=1.10.0); 
	select BR2_PACKAGE_PYTHON_FASTENERS # (>=0.7.0); 
	help
	  Oslo Concurrency library

	  https://docs.openstack.org/oslo.concurrency/latest/
```

## BR2_EXTERNAL/package/python-oslo.config/Config.in
```kconfig
# vim: noexpandtab filetype=make
config BR2_PACKAGE_PYTHON_OSLOCONFIG
	bool "python-oslo.config"
	depends on BR2_PACKAGE_PYTHON3
	select BR2_PACKAGE_PYTHON_DEBTCOLLECTOR # (>=1.2.0); 
	select BR2_PACKAGE_PYTHON_NETADDR # (>=0.7.18); 
	select BR2_PACKAGE_PYTHON_SIX # (>=1.10.0); 
	select BR2_PACKAGE_PYTHON_STEVEDORE # (>=1.20.0); 
	select BR2_PACKAGE_PYTHON_OSLOI18N # (>=3.15.3); 
	select BR2_PACKAGE_PYTHON_RFC3986 # (>=1.2.0); 
	select BR2_PACKAGE_PYTHON_PYYAML # (>=3.12); 
	select BR2_PACKAGE_PYTHON_REQUESTS # (>=2.18.0); 
	help
	  Oslo Configuration API

	  https://docs.openstack.org/oslo.config/latest/
```

## BR2_EXTERNAL/package/python-oslo.context/Config.in
```kconfig
# vim: noexpandtab filetype=make
config BR2_PACKAGE_PYTHON_OSLOCONTEXT
	bool "python-oslo.context"
	depends on BR2_PACKAGE_PYTHON3
	select BR2_PACKAGE_PYTHON_PBR # (!=2.1.0,>=2.0.0); 
	select BR2_PACKAGE_PYTHON_DEBTCOLLECTOR # (>=1.2.0); 
	help
	  Oslo Context library

	  https://docs.openstack.org/oslo.context/latest/
```

## BR2_EXTERNAL/package/python-oslo.db/Config.in
```kconfig
# vim: noexpandtab filetype=make
config BR2_PACKAGE_PYTHON_OSLODB
	bool "python-oslo.db"
	depends on BR2_PACKAGE_PYTHON3
	select BR2_PACKAGE_PYTHON_PBR
	select BR2_PACKAGE_PYTHON_ALEMBIC
	select BR2_PACKAGE_PYTHON_DEBTCOLLECTOR
	select BR2_PACKAGE_PYTHON_OSLOI18N
	select BR2_PACKAGE_PYTHON_OSLOCONFIG
	select BR2_PACKAGE_PYTHON_OSLOUTILS
	select BR2_PACKAGE_PYTHON_SQLALCHEMY
	select BR2_PACKAGE_PYTHON_SQLALCHEMY_MIGRATE
	select BR2_PACKAGE_PYTHON_STEVEDORE
	select BR2_PACKAGE_PYTHON_TESTRESOURCES
	select BR2_PACKAGE_PYTHON_TESTSCENARIOS
	select BR2_PACKAGE_PYTHON_PYMYSQL
	select BR2_PACKAGE_PYTHON_PSYCOPG2
s	help
	  Oslo Database library

	  https://docs.openstack.org/oslo.db/latest
```

## BR2_EXTERNAL/package/python-oslo.i18n/Config.in
```kconfig
# vim: noexpandtab filetype=make
config BR2_PACKAGE_PYTHON_OSLOI18N
	bool "python-oslo.i18n"
	depends on BR2_PACKAGE_PYTHON3
	select BR2_PACKAGE_PYTHON_PBR # (!=2.1.0,>=2.0.0); 
	select BR2_PACKAGE_PYTHON_BABEL # (!=2.4.0,>=2.3.4); 
	select BR2_PACKAGE_PYTHON_SIX # (>=1.10.0); 
	help
	  Oslo i18n library

	  https://docs.openstack.org/oslo.i18n/latest
```

## BR2_EXTERNAL/package/python-oslo.log/Config.in
```kconfig
# vim: noexpandtab filetype=make
config BR2_PACKAGE_PYTHON_OSLOLOG
	bool "python-oslo.log"
	depends on BR2_PACKAGE_PYTHON3
	select BR2_PACKAGE_PYTHON_PBR # (>=3.1.1); 
	select BR2_PACKAGE_PYTHON_SIX # (>=1.11.0); 
	select BR2_PACKAGE_PYTHON_OSLOCONFIG # (>=5.2.0); 
	select BR2_PACKAGE_PYTHON_OSLOCONTEXT # (>=2.20.0); 
	select BR2_PACKAGE_PYTHON_OSLOI18N # (>=3.20.0); 
	select BR2_PACKAGE_PYTHON_OSLOUTILS # (>=3.36.0); 
	select BR2_PACKAGE_PYTHON_OSLOSERIALIZATION # (>=2.25.0); 
	select BR2_PACKAGE_PYTHON_DEBTCOLLECTOR # (>=1.19.0); 
	select BR2_PACKAGE_PYTHON_PYTHON_DATEUTIL # (>=2.7.0); 
	select BR2_PACKAGE_PYTHON_PYINOTIFY # (>=0.9.6); (sys_platform!='win32' and sys_platform!='darwin' and sys_platform!='sunos5')
	select BR2_PACKAGE_PYTHON_SYSTEMD_PYTHON # (>=234); extra == 'systemd'
	help
	  oslo.log library

	  https://docs.openstack.org/oslo.log/latest
```

## BR2_EXTERNAL/package/python-oslo.serialization/Config.in
```kconfig
# vim: noexpandtab filetype=make
config BR2_PACKAGE_PYTHON_OSLOSERIALIZATION
	bool "python-oslo.serialization"
	depends on BR2_PACKAGE_PYTHON3
	select BR2_PACKAGE_PYTHON_PBR # (!=2.1.0,>=2.0.0); 
	select BR2_PACKAGE_PYTHON_SIX # (>=1.10.0); 
	select BR2_PACKAGE_PYTHON_MSGPACK # (>=0.5.2); 
	select BR2_PACKAGE_PYTHON_OSLOUTILS # (>=3.33.0); 
	select BR2_PACKAGE_PYTHON_PYTZ # (>=2013.6); 
	select BR2_PACKAGE_PYTHON_PYYAML # (>=3.12); 
	select BR2_PACKAGE_PYTHON_DEBTCOLLECTOR # (>=1.2.0); 
	help
	  Oslo Serialization library

	  https://docs.openstack.org/oslo.serialization/latest/
```
