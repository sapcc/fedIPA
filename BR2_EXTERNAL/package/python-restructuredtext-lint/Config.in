## BR2_EXTERNAL/package/python-restructuredtext-lint/Config.in
```kconfig
# vim: noexpandtab filetype=make
config BR2_PACKAGE_PYTHON_RESTRUCTUREDTEXT_LINT
	bool "python-restructuredtext-lint"
	help
	  reStructuredText linter

	  https://github.com/twolfson/restructuredtext-lint
```

## BR2_EXTERNAL/package/python-rfc3986/Config.in
```kconfig
# vim: noexpandtab filetype=make
config BR2_PACKAGE_PYTHON_RFC3986
	bool "python-rfc3986"
	help
	  Validating URI References per RFC 3986

	  http://rfc3986.readthedocs.io
```

## BR2_EXTERNAL/package/python-routes/Config.in
```kconfig
# vim: noexpandtab filetype=make
config BR2_PACKAGE_PYTHON_ROUTES
	bool "python-routes"
	select BR2_PACKAGE_PYTHON_REPOZELRU # (>=0.3); 
	select BR2_PACKAGE_PYTHON_SIX # ; 
	help
	  Routing Recognition and Generation Tools

	  https://routes.readthedocs.io/
```

## BR2_EXTERNAL/package/python-rst.linker/Config.in
```kconfig
# vim: noexpandtab filetype=make
config BR2_PACKAGE_PYTHON_RSTLINKER
	bool "python-rst.linker"
	depends on BR2_PACKAGE_PYTHON3
	select BR2_PACKAGE_PYTHON_DATEUTIL
	select BR2_PACKAGE_PYTHON_IMPORTLIB_METADATA
	select BR2_PACKAGE_PYTHON_SPHINX
	select BR2_PACKAGE_PYTHON_JARACOPACKAGING
	select BR2_PACKAGE_PYTHON_RSTLINKER
	select BR2_PACKAGE_PYTHON_PYTEST
	select BR2_PACKAGE_PYTHON_PYTEST_CHECKDOCS
	select BR2_PACKAGE_PYTHON_PYTEST_FLAKE8
	select BR2_PACKAGE_PYTHON_PYTEST_BLACK_MULTIPY
	select BR2_PACKAGE_PYTHON_PYTEST_COV
	select BR2_PACKAGE_PYTHON_PATHPY
	help
	  Tools for adding metadata and hyperlinks to reStructuredText

	  https://github.com/jaraco/rst.linker
```

## BR2_EXTERNAL/package/python-six/Config.in
```kconfig
# vim: noexpandtab filetype=make
config BR2_PACKAGE_PYTHON_SIX
	bool "python-six"
	help
	  Six is a Python 2 and 3 compatibility library.
	  
	  https://six.readthedocs.io/
```

## BR2_EXTERNAL/package/python-snowballstemmer/Config.in
```kconfig
# vim: noexpandtab filetype=make
config BR2_PACKAGE_PYTHON_SNOWBALLSTEMMER
	bool "python-snowballstemmer"
	help
	  This package provides 26 stemmers for 25 languages generated from Snowball algorithms.

	  https://github.com/snowballstem/snowball
```

## BR2_EXTERNAL/package/python-sphinx-argparse/Config.in
```kconfig
# vim: noexpandtab filetype=make
config BR2_PACKAGE_PYTHON_SPHINX_ARGPARSE
	bool "python-sphinx-argparse"
	help
	  A sphinx extension that automatically documents argparse commands and options

	  https://github.com/ribozz/sphinx-argparse
```

## BR2_EXTERNAL/package/python-sphinx-autobuild/Config.in
```kconfig
# vim: noexpandtab filetype=make
config BR2_PACKAGE_PYTHON_SPHINX_AUTOBUILD
	bool "python-sphinx-autobuild"
	help
	  Watch a Sphinx directory and rebuild the documentation when a change is detected. Also includes a livereload enabled web server.

	  https://github.com/GaretJax/sphinx-autobuild
```

## BR2_EXTERNAL/package/python-sphinx-rtd-theme/Config.in
```kconfig
# vim: noexpandtab filetype=make
config BR2_PACKAGE_PYTHON_PYTHON_SPHINX_RTD_THEME
	bool "python-sphinx-rtd-theme"
	depends on BR2_PACKAGE_PYTHON3
	select BR2_PACKAGE_PYTHON_SPHINX
	help
	  Read the Docs theme for Sphinx

	  https://github.com/rtfd/sphinx_rtd_theme/
```

## BR2_EXTERNAL/package/python-sphinx/Config.in
```kconfig
# vim: noexpandtab filetype=make
config BR2_PACKAGE_PYTHON_SPHINX
	bool "python-sphinx"
	depends on BR2_PACKAGE_PYTHON3
	select BR2_PACKAGE_PYTHON_SPHINXCONTRIB_APPLEHELP
	select BR2_PACKAGE_PYTHON_SPHINXCONTRIB_DEVHELP
	select BR2_PACKAGE_PYTHON_SPHINXCONTRIB_JSMATH
	select BR2_PACKAGE_PYTHON_SPHINXCONTRIB_HTMLHELP
	select BR2_PACKAGE_PYTHON_SPHINXCONTRIB_SERIALIZINGHTML
	select BR2_PACKAGE_PYTHON_SPHINXCONTRIB_QTHELP
	select BR2_PACKAGE_PYTHON_JINJA2
	select BR2_PACKAGE_PYTHON_PYGMENTS
	select BR2_PACKAGE_PYTHON_DOCUTILS
	select BR2_PACKAGE_PYTHON_SNOWBALLSTEMMER
	select BR2_PACKAGE_PYTHON_BABEL
	select BR2_PACKAGE_PYTHON_ALABASTER
	select BR2_PACKAGE_PYTHON_IMAGESIZE
	select BR2_PACKAGE_PYTHON_REQUESTS
	select BR2_PACKAGE_PYTHON_SETUPTOOLS
	select BR2_PACKAGE_PYTHON_PACKAGING
	select BR2_PACKAGE_PYTHON_COLORAMA
	select BR2_PACKAGE_PYTHON_SPHINXCONTRIB_WEBSUPPORT
	select BR2_PACKAGE_PYTHON_PYTEST
	select BR2_PACKAGE_PYTHON_PYTEST_COV
	select BR2_PACKAGE_PYTHON_HTML5LIB
	select BR2_PACKAGE_PYTHON_FLAKE8
	select BR2_PACKAGE_PYTHON_FLAKE8_IMPORT_ORDER
	select BR2_PACKAGE_PYTHON_MYPY
	select BR2_PACKAGE_PYTHON_DOCUTILS_STUBS
	help
	  Python documentation generator

	  http://sphinx-doc.org/
```

## BR2_EXTERNAL/package/python-sphinxcontrib-applehelp/Config.in
```kconfig
# vim: noexpandtab filetype=make
config BR2_PACKAGE_PYTHON_PYTHON_SPHINXCONTRIB_APPLEHELP
	bool "python-sphinxcontrib-applehelp"
	depends on BR2_PACKAGE_PYTHON3
	select BR2_PACKAGE_PYTHON_FLAKE8
	select BR2_PACKAGE_PYTHON_MYPY
	select BR2_PACKAGE_PYTHON_DOCUTILS_STUBS
	select BR2_PACKAGE_PYTHON_PYTEST
	help
	  sphinxcontrib-applehelp is a sphinx extension which outputs Apple help books

	  http://sphinx-doc.org/
```

## BR2_EXTERNAL/package/python-sphinxcontrib-autoprogram/Config.in
```kconfig
# vim: noexpandtab filetype=make
config BR2_PACKAGE_PYTHON_PYTHON_SPHINXCONTRIB_AUTOPROGRAM
	bool "python-sphinxcontrib-autoprogram"
	select BR2_PACKAGE_PYTHON_SPHINX
	select BR2_PACKAGE_PYTHON_SIX
	help
	  Documenting CLI programs

	  https://github.com/sphinx-contrib/autoprogram
```

## BR2_EXTERNAL/package/python-sphinxcontrib-devhelp/Config.in
```kconfig
# vim: noexpandtab filetype=make
config BR2_PACKAGE_PYTHON_SPHINXCONTRIB_DEVHELP
	bool "python-sphinxcontrib-devhelp"
	depends on BR2_PACKAGE_PYTHON3
	select BR2_PACKAGE_PYTHON_FLAKE8
	select BR2_PACKAGE_PYTHON_MYPY
	select BR2_PACKAGE_PYTHON_DOCUTILS_STUBS
	select BR2_PACKAGE_PYTHON_PYTEST
	help
	  sphinxcontrib-devhelp is a sphinx extension which outputs Devhelp document.

	  http://sphinx-doc.org/
```

## BR2_EXTERNAL/package/python-sphinxcontrib-htmlhelp/Config.in
```kconfig
# vim: noexpandtab filetype=make
config BR2_PACKAGE_PYTHON_SPHINXCONTRIB_HTMLHELP
	bool "python-sphinxcontrib-htmlhelp"
	depends on BR2_PACKAGE_PYTHON3
	select BR2_PACKAGE_PYTHON_FLAKE8
	select BR2_PACKAGE_PYTHON_MYPY
	select BR2_PACKAGE_PYTHON_DOCUTILS_STUBS
	help
	  sphinxcontrib-htmlhelp is a sphinx extension which renders HTML help files

	  http://sphinx-doc.org/
```

## BR2_EXTERNAL/package/python-sphinxcontrib-jsmath/Config.in
```kconfig
# vim: noexpandtab filetype=make
config BR2_PACKAGE_PYTHON_SPHINXCONTRIB_JSMATH
	bool "python-sphinxcontrib-jsmath"
	depends on BR2_PACKAGE_PYTHON3
	help
	  A sphinx extension which renders display math in HTML via JavaScript

	  http://sphinx-doc.org/
```

## BR2_EXTERNAL/package/python-sphinxcontrib-qthelp/Config.in
```kconfig
# vim: noexpandtab filetype=make
config BR2_PACKAGE_PYTHON_SPHINXCONTRIB_QTHELP
	bool "python-sphinxcontrib-qthelp"
	depends on BR2_PACKAGE_PYTHON3
	select BR2_PACKAGE_PYTHON_FLAKE8
	select BR2_PACKAGE_PYTHON_MYPY
	select BR2_PACKAGE_PYTHON_DOCUTILS_STUBS
	select BR2_PACKAGE_PYTHON_PYTEST
	help
	  sphinxcontrib-qthelp is a sphinx extension which outputs QtHelp document.

	  http://sphinx-doc.org/
```

## BR2_EXTERNAL/package/python-sphinxcontrib-serializinghtml/Config.in
```kconfig
# vim: noexpandtab filetype=make
config BR2_PACKAGE_PYTHON_SPHINXCONTRIB_SERIALIZINGHTML
	bool "python-sphinxcontrib-serializinghtml"
	depends on BR2_PACKAGE_PYTHON3
	select BR2_PACKAGE_PYTHON_FLAKE8
	select BR2_PACKAGE_PYTHON_MYPY
	select BR2_PACKAGE_PYTHON_DOCUTILS_STUBS
	help
	  sphinxcontrib-serializinghtml is a sphinx extension which outputs "serialized" HTML files (json and pickle).

	  http://sphinx-doc.org/
```

## BR2_EXTERNAL/package/python-sphinxcontrib-websupport/Config.in
```kconfig
# vim: noexpandtab filetype=make
config BR2_PACKAGE_PYTHON_SPHINXCONTRIB_WEBSUPPORT
	bool "python-sphinxcontrib-websupport"
	depends on BR2_PACKAGE_PYTHON3
	select BR2_PACKAGE_PYTHON_FLAKE8
	help
	  Sphinx API for Web Apps

	  http://sphinx-doc.org/
```

## BR2_EXTERNAL/package/python-sqlalchemy-migrate/Config.in
```kconfig
# vim: noexpandtab filetype=make
config BR2_PACKAGE_PYTHON_SQLALCHEMY_MIGRATE
	bool "python-sqlalchemy-migrate"
	select BR2_PACKAGE_PYTHON_PBR
	select BR2_PACKAGE_PYTHON_SQLALCHEMY
	select BR2_PACKAGE_PYTHON_DECORATOR
	select BR2_PACKAGE_PYTHON_SIX
	select BR2_PACKAGE_PYTHON_SQLPARSE
	select BR2_PACKAGE_PYTHON_TEMPITA
	help
	  Database schema migration for SQLAlchemy

	  http://www.openstack.org/
```

## BR2_EXTERNAL/package/python-stestr/Config.in
```kconfig
# vim: noexpandtab filetype=make
config BR2_PACKAGE_PYTHON_STESTR
	bool "python-stestr"
	depends on BR2_PACKAGE_PYTHON3
	select BR2_PACKAGE_PYTHON_FUTURE
	select BR2_PACKAGE_PYTHON_PBR
	select BR2_PACKAGE_PYTHON_CLIFF
	select BR2_PACKAGE_PYTHON_SUBUNIT
	select BR2_PACKAGE_PYTHON_FIXTURES
	select BR2_PACKAGE_PYTHON_TESTTOOLS
	select BR2_PACKAGE_PYTHON_PYYAML
	select BR2_PACKAGE_PYTHON_VOLUPTUOUS
	select BR2_PACKAGE_PYTHON_SUBUNIT2SQL
	help
	  A parallel Python test runner built around subunit

	  http://stestr.readthedocs.io/en/latest/
```

## BR2_EXTERNAL/package/python-stevedore/Config.in
```kconfig
# vim: noexpandtab filetype=make
config BR2_PACKAGE_PYTHON_STEVEDORE
	bool "python-stevedore"
	select BR2_PACKAGE_PYTHON_PBR # (!=2.1.0,>=2.0.0); 
	select BR2_PACKAGE_PYTHON_SIX # (>=1.10.0); 
	help
	  Manage dynamic plugins for Python applications

	  https://docs.openstack.org/stevedore/latest/
```

## BR2_EXTERNAL/package/python-subunit2sql/Config.in
```kconfig
# vim: noexpandtab filetype=make
config BR2_PACKAGE_PYTHON_SUBUNIT2SQL
	bool "python-subunit2sql"
	select BR2_PACKAGE_PYTHON_PBR
	select BR2_PACKAGE_PYTHON_ALEMBIC
	select BR2_PACKAGE_PYTHON_OSLOCONFIG
	select BR2_PACKAGE_PYTHON_OSLODB
	select BR2_PACKAGE_PYTHON_SUBUNIT
	select BR2_PACKAGE_PYTHON_SIX
	select BR2_PACKAGE_PYTHON_SQLALCHEMY
	select BR2_PACKAGE_PYTHON_STEVEDORE
	select BR2_PACKAGE_PYTHON_DATEUTIL
	select BR2_PACKAGE_PYTHON_PANDAS
	select BR2_PACKAGE_PYTHON_MATPLOTLIB
	help
	  Command to Read a subunit file or stream and put the data in a SQL DB

	  https://pypi.org/project/subunit2sql/
```

## BR2_EXTERNAL/package/python-systemd-python/Config.in
```kconfig
# vim: noexpandtab filetype=make
config BR2_PACKAGE_PYTHON_SYSTEMD_PYTHON
	bool "python-systemd-python"
	help
	  Python interface for libsystemd

	  https://github.com/systemd/python-systemd
```

## BR2_EXTERNAL/package/python-systemd/Config.in
```kconfig
# vim: noexpandtab filetype=make
config BR2_PACKAGE_PYTHON_SYSTEMD
	bool "python-systemd"
	help
	  Python systemd wrapper using Cython
	  
	  https://github.com/mosquito/cysystemd
```

## BR2_EXTERNAL/package/python-tempita/Config.in
```kconfig
# vim: noexpandtab filetype=make
config BR2_PACKAGE_PYTHON_PYTHON_TEMPITA
	bool "python-tempita"
	help
	  A very small text templating language

	  http://pythonpaste.org/tempita/
```
