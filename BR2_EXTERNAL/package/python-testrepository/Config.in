## BR2_EXTERNAL/package/python-testrepository/Config.in
```kconfig
# vim: noexpandtab filetype=make
config BR2_PACKAGE_PYTHON_TESTREPOSITORY
	bool "python-testrepository"
	depends on BR2_PACKAGE_PYTHON3
	help
	  A repository of test results.

	  https://launchpad.net/testrepository
```

## BR2_EXTERNAL/package/python-testresources/Config.in
```kconfig
# vim: noexpandtab filetype=make
config BR2_PACKAGE_PYTHON_PYTHON_TESTRESOURCES
	bool "python-testresources"
	help
	  Testresources, a pyunit extension for managing expensive test resources

	  https://launchpad.net/testresources
```

## BR2_EXTERNAL/package/python-testscenarios/Config.in
```kconfig
# vim: noexpandtab filetype=make
config BR2_PACKAGE_PYTHON_PYTHON_TESTSCENARIOS
	bool "python-testscenarios"
	depends on BR2_PACKAGE_PYTHON3
	help
	  Testscenarios, a pyunit extension for dependency injection

	  https://launchpad.net/testscenarios
```

## BR2_EXTERNAL/package/python-testtools/Config.in
```kconfig
# vim: noexpandtab filetype=make
config BR2_PACKAGE_PYTHON_TESTTOOLS
	bool "python-testtools"
	help
	  Extensions to the Python standard library unit testing framework

	  https://github.com/testing-cabal/testtools
```

## BR2_EXTERNAL/package/python-towncrier/Config.in
```kconfig
# vim: noexpandtab filetype=make
config BR2_PACKAGE_PYTHON_PYTHON_TOWNCRIER
	bool "python-towncrier"
	select BR2_PACKAGE_PYTHON_CLICK
	select BR2_PACKAGE_PYTHON_INCREMENTAL
	select BR2_PACKAGE_PYTHON_JINJA2
	select BR2_PACKAGE_PYTHON_TOML
	help
	  Building newsfiles for your project.

	  https://github.com/hawkowl/towncrier
```

## BR2_EXTERNAL/package/python-tox/Config.in
```kconfig
# vim: noexpandtab filetype=make
config BR2_PACKAGE_PYTHON_TOX
	bool "python-tox"
	select BR2_PACKAGE_PYTHON_PACKAGING
	select BR2_PACKAGE_PYTHON_PLUGGY
	select BR2_PACKAGE_PYTHON_PY
	select BR2_PACKAGE_PYTHON_SIX
	select BR2_PACKAGE_PYTHON_VIRTUALENV
	select BR2_PACKAGE_PYTHON_TOML
	select BR2_PACKAGE_PYTHON_FILELOCK
	select BR2_PACKAGE_PYTHON_COLORAMA
	select BR2_PACKAGE_PYTHON_IMPORTLIB_METADATA
	select BR2_PACKAGE_PYTHON_SPHINX
	select BR2_PACKAGE_PYTHON_TOWNCRIER
	select BR2_PACKAGE_PYTHON_PYGMENTS_GITHUB_LEXERS
	select BR2_PACKAGE_PYTHON_SPHINXCONTRIB_AUTOPROGRAM
	select BR2_PACKAGE_PYTHON_FREEZEGUN
	select BR2_PACKAGE_PYTHON_PATHLIB2
	select BR2_PACKAGE_PYTHON_PYTEST
	select BR2_PACKAGE_PYTHON_PYTEST_COV
	select BR2_PACKAGE_PYTHON_PYTEST_MOCK
	select BR2_PACKAGE_PYTHON_PYTEST_XDIST
	select BR2_PACKAGE_PYTHON_PYTEST_RANDOMLY
	select BR2_PACKAGE_PYTHON_FLAKY
	select BR2_PACKAGE_PYTHON_PSUTIL
	help
	  tox is a generic virtualenv management and test command line tool

	  http://tox.readthedocs.org
```

## BR2_EXTERNAL/package/python-twine/Config.in
```kconfig
# vim: noexpandtab filetype=make
config BR2_PACKAGE_PYTHON_TWINE
	bool "python-twine"
	depends on BR2_PACKAGE_PYTHON3
	select BR2_PACKAGE_PYTHON_PKGINFO
	select BR2_PACKAGE_PYTHON_README_RENDERER
	select BR2_PACKAGE_PYTHON_REQUESTS
	select BR2_PACKAGE_PYTHON_REQUESTS_TOOLBELT
	select BR2_PACKAGE_PYTHON_SETUPTOOLS
	select BR2_PACKAGE_PYTHON_TQDM
	select BR2_PACKAGE_PYTHON_KEYRING
	select BR2_PACKAGE_PYTHON_IMPORTLIB_METADATA
	help
	  Collection of utilities for publishing packages on PyPI

	  https://twine.readthedocs.io/
```

## BR2_EXTERNAL/package/python-typed-ast/Config.in
```kconfig
# vim: noexpandtab filetype=make
config BR2_PACKAGE_PYTHON_TYPED_AST
	bool "python-typed-ast"
	help
	  a fork of Python 2 and 3 ast modules with type comment support

	  https://github.com/python/typed_ast
```

## BR2_EXTERNAL/package/python-uncertainties/Config.in
```kconfig
# vim: noexpandtab filetype=make
config BR2_PACKAGE_PYTHON_UNCERTAINTIES
	bool "python-uncertainties"
	help
	  Transparent calculations with uncertainties on the quantities
	  involved (aka error propagation); fast calculation of
	  derivatives

	  http://uncertainties-python-package.readthedocs.io/
```

## BR2_EXTERNAL/package/python-uwsgi/Config.in
```kconfig
# vim: noexpandtab filetype=make
config BR2_PACKAGE_PYTHON_PYTHON_UWSGI
	bool "python-uwsgi"
	help
	  The uWSGI server

	  https://uwsgi-docs.readthedocs.io/en/latest/
```

## BR2_EXTERNAL/package/python-virtualenv/Config.in
```kconfig
# vim: noexpandtab filetype=make
config BR2_PACKAGE_PYTHON_VIRTUALENV
	bool "python-virtualenv"
	select BR2_PACKAGE_PYTHON_APPDIRS
	select BR2_PACKAGE_PYTHON_DISTLIB
	select BR2_PACKAGE_PYTHON_FILELOCK
	select BR2_PACKAGE_PYTHON_SIX
	help
	  Virtual Python Environment builder

	  https://virtualenv.pypa.io/
```

## BR2_EXTERNAL/package/python-voluptuous/Config.in
```kconfig
# vim: noexpandtab filetype=make
config BR2_PACKAGE_PYTHON_VOLUPTUOUS
	bool "python-voluptuous"
	help
	  # Voluptuous is a Python data validation library

	  https://github.com/alecthomas/voluptuous
```

## BR2_EXTERNAL/package/python-wheel/Config.in
```kconfig
# vim: noexpandtab filetype=make
config BR2_PACKAGE_PYTHON_WHEEL
	bool "python-wheel"
	help
	  A built-package format for Python

	  https://github.com/pypa/wheel
```

## BR2_EXTERNAL/package/python-wrapt/Config.in
```kconfig
# vim: noexpandtab filetype=make
config BR2_PACKAGE_PYTHON_WRAPT
	bool "python-wrapt"
	help
	  Module for decorators, wrappers and monkey patching.
	  
	  http://wrapt.readthedocs.org/
```

## BR2_EXTERNAL/package/python-xattr/Config.in
```kconfig
# vim: noexpandtab filetype=make
config BR2_PACKAGE_PYTHON_PYTHON_XATTR
	bool "python-xattr"
	select BR2_PACKAGE_PYTHON_CFFI
	help
	  Python wrapper for extended filesystem attributes

	  http://github.com/xattr/xattr
```

## BR2_EXTERNAL/package/python-xmlschema/Config.in
```kconfig
# vim: noexpandtab filetype=make
config BR2_PACKAGE_PYTHON_XMLSCHEMA
	bool "python-xmlschema"
	select BR2_PACKAGE_PYTHON_ELEMENTPATH
	help
	  An XML Schema validator and decoder

	  https://github.com/brunato/xmlschema
```

## BR2_EXTERNAL/package/python-xonsh/Config.in
```kconfig
# vim: noexpandtab filetype=make
config BR2_PACKAGE_PYTHON_PYTHON_XONSH
	bool "python-xonsh"
	depends on BR2_PACKAGE_PYTHON3
	help
	  Python-powered, cross-platform, Unix-gazing shell

	  https://github.com/xonsh/xonsh
```

## BR2_EXTERNAL/package/python-yappi/Config.in
```kconfig
# vim: noexpandtab filetype=make
config BR2_PACKAGE_PYTHON_PYTHON_YAPPI
	bool "python-yappi"
	help
	  Yet Another Python Profiler

	  https://github.com/sumerc/yappi
```

## BR2_EXTERNAL/package/python-zipp/Config.in
```kconfig
# vim: noexpandtab filetype=make
config BR2_PACKAGE_PYTHON_PYTHON_ZIPP
	bool "python-zipp"
	depends on BR2_PACKAGE_PYTHON3
	select BR2_PACKAGE_PYTHON_SPHINX
	select BR2_PACKAGE_PYTHON_JARACOPACKAGING
	select BR2_PACKAGE_PYTHON_RSTLINKER
	select BR2_PACKAGE_PYTHON_JARACOITERTOOLS
	select BR2_PACKAGE_PYTHON_FUNC_TIMEOUT
	help
	  Backport of pathlib-compatible object wrapper for zip files

	  https://github.com/jaraco/zipp
```
