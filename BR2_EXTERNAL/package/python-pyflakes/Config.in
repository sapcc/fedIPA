## BR2_EXTERNAL/package/python-pyflakes/Config.in
```kconfig
# vim: noexpandtab filetype=make
config BR2_PACKAGE_PYTHON_PYFLAKES
	bool "python-pyflakes"
	help
	  passive checker of Python programs

	  https://github.com/PyCQA/pyflakes
```

## BR2_EXTERNAL/package/python-pygments-github-lexers/Config.in
```kconfig
# vim: noexpandtab filetype=make
config BR2_PACKAGE_PYTHON_PYTHON_PYGMENTS_GITHUB_LEXERS
	bool "python-pygments-github-lexers"
	help
	  Pygments Github custom lexers.

	  https://github.com/liluo/pygments-github-lexers
```

## BR2_EXTERNAL/package/python-pylons-sphinx-themes/Config.in
```kconfig
# vim: noexpandtab filetype=make
config BR2_PACKAGE_PYTHON_PYTHON_PYLONS_SPHINX_THEMES
	bool "python-pylons-sphinx-themes"
	help
	  Sphinx themes for Pylons Project documentation.

	  https://pylonsproject.org
```

## BR2_EXTERNAL/package/python-pyperclip/Config.in
```kconfig
# vim: noexpandtab filetype=make
config BR2_PACKAGE_PYTHON_PYPERCLIP
	bool "python-pyperclip"
	help
	  A cross-platform clipboard module for Python. (Only handles plain text for now.)

	  https://github.com/asweigart/pyperclip
```

## BR2_EXTERNAL/package/python-pyreadline/Config.in
```kconfig
# vim: noexpandtab filetype=make
config BR2_PACKAGE_PYTHON_PYREADLINE
	bool "python-pyreadline"
	help
	  A python implmementation of GNU readline.

	  http://ipython.org/pyreadline.html
```

## BR2_EXTERNAL/package/python-pytest-asyncio/Config.in
```kconfig
# vim: noexpandtab filetype=make
config BR2_PACKAGE_PYTHON_PYTHON_PYTEST_ASYNCIO
	bool "python-pytest-asyncio"
	select BR2_PACKAGE_PYTHON_PYTEST
	select BR2_PACKAGE_PYTHON_ASYNC_GENERATOR
	select BR2_PACKAGE_PYTHON_ASYNC_GENERATOR
	select BR2_PACKAGE_PYTHON_COVERAGE
	select BR2_PACKAGE_PYTHON_HYPOTHESIS
	help
	  Pytest support for asyncio.

	  https://github.com/pytest-dev/pytest-asyncio
```

## BR2_EXTERNAL/package/python-pytest-black-multipy/Config.in
```kconfig
# vim: noexpandtab filetype=make
config BR2_PACKAGE_PYTHON_PYTEST_BLACK_MULTIPY
	bool "python-pytest-black-multipy"
	depends on BR2_PACKAGE_PYTHON3
	select BR2_PACKAGE_PYTHON_PYTEST_BLACK
	select BR2_PACKAGE_PYTHON_SPHINX
	select BR2_PACKAGE_PYTHON_JARACOPACKAGING
	select BR2_PACKAGE_PYTHON_RSTLINKER
	select BR2_PACKAGE_PYTHON_PYTEST
	select BR2_PACKAGE_PYTHON_PYTEST_CHECKDOCS
	select BR2_PACKAGE_PYTHON_PYTEST_FLAKE8
	help
	  Allow '--black' on older Pythons

	  https://github.com/jaraco/skeleton
```

## BR2_EXTERNAL/package/python-pytest-black/Config.in
```kconfig
# vim: noexpandtab filetype=make
config BR2_PACKAGE_PYTHON_PYTEST_BLACK
	bool "python-pytest-black"
	depends on BR2_PACKAGE_PYTHON3
	help
	  A pytest plugin to enable format checking with black

	  https://github.com/shopkeep/pytest-black
```

## BR2_EXTERNAL/package/python-pytest-checkdocs/Config.in
```kconfig
# vim: noexpandtab filetype=make
config BR2_PACKAGE_PYTHON_PYTHON_PYTEST_CHECKDOCS
	bool "python-pytest-checkdocs"
	depends on BR2_PACKAGE_PYTHON3
	select BR2_PACKAGE_PYTHON_DOCUTILS
	select BR2_PACKAGE_PYTHON_IMPORTLIB_METADATA
	select BR2_PACKAGE_PYTHON_MORE_ITERTOOLS
	select BR2_PACKAGE_PYTHON_SPHINX
	select BR2_PACKAGE_PYTHON_JARACOPACKAGING
	select BR2_PACKAGE_PYTHON_RSTLINKER
	select BR2_PACKAGE_PYTHON_PYTEST
	select BR2_PACKAGE_PYTHON_PYTEST_CHECKDOCS
	select BR2_PACKAGE_PYTHON_PYTEST_FLAKE8
	select BR2_PACKAGE_PYTHON_PYTEST_BLACK_MULTIPY
	select BR2_PACKAGE_PYTHON_PYTEST_COV
	help
	  check the README when running tests

	  https://github.com/jaraco/pytest-checkdocs
```

## BR2_EXTERNAL/package/python-pytest-cov/Config.in
```kconfig
# vim: noexpandtab filetype=make
config BR2_PACKAGE_PYTHON_PYTEST_COV
	bool "python-pytest-cov"
	select BR2_PACKAGE_PYTHON_PYTEST
	select BR2_PACKAGE_PYTHON_COVERAGE
	select BR2_PACKAGE_PYTHON_FIELDS
	select BR2_PACKAGE_PYTHON_HUNTER
	select BR2_PACKAGE_PYTHON_PROCESS_TESTS
	select BR2_PACKAGE_PYTHON_SIX
	select BR2_PACKAGE_PYTHON_VIRTUALENV
	help
	  Pytest plugin for measuring coverage.

	  https://github.com/pytest-dev/pytest-cov
```

## BR2_EXTERNAL/package/python-pytest-env/Config.in
```kconfig
# vim: noexpandtab filetype=make
config BR2_PACKAGE_PYTHON_PYTHON_PYTEST_ENV
	bool "python-pytest-env"
	help
	  py.test plugin that allows you to add environment variables.

	  https://github.com/MobileDynasty/pytest-env
```

## BR2_EXTERNAL/package/python-pytest-flake8/Config.in
```kconfig
# vim: noexpandtab filetype=make
config BR2_PACKAGE_PYTHON_PYTEST_FLAKE8
	bool "python-pytest-flake8"
	select BR2_PACKAGE_PYTHON_FLAKE8
	select BR2_PACKAGE_PYTHON_PYTEST
	help
	  pytest plugin to check FLAKE8 requirements

	  https://github.com/tholo/pytest-flake8
```

## BR2_EXTERNAL/package/python-pytest-forked/Config.in
```kconfig
# vim: noexpandtab filetype=make
config BR2_PACKAGE_PYTHON_PYTHON_PYTEST_FORKED
	bool "python-pytest-forked"
	select BR2_PACKAGE_PYTHON_PYTEST
	help
	  run tests in isolated forked subprocesses

	  https://github.com/pytest-dev/pytest-forked
```

## BR2_EXTERNAL/package/python-pytest-mock/Config.in
```kconfig
# vim: noexpandtab filetype=make
config BR2_PACKAGE_PYTHON_PYTHON_PYTEST_MOCK
	bool "python-pytest-mock"
	depends on BR2_PACKAGE_PYTHON3
	select BR2_PACKAGE_PYTHON_PYTEST
	select BR2_PACKAGE_PYTHON_PRE_COMMIT
	select BR2_PACKAGE_PYTHON_TOX
	select BR2_PACKAGE_PYTHON_PYTEST_ASYNCIO
	help
	  Thin-wrapper around the mock package for easier use with pytest

	  https://github.com/pytest-dev/pytest-mock/
```

## BR2_EXTERNAL/package/python-pytest-mpl/Config.in
```kconfig
# vim: noexpandtab filetype=make
config BR2_PACKAGE_PYTHON_PYTHON_PYTEST_MPL
	bool "python-pytest-mpl"
	select BR2_PACKAGE_PYTHON_PYTEST
	select BR2_PACKAGE_PYTHON_MATPLOTLIB
	select BR2_PACKAGE_PYTHON_PILLOW
	select BR2_PACKAGE_PYTHON_NOSE
	help
	  pytest plugin to help with testing figures output from Matplotlib

	  https://github.com/matplotlib/pytest-mpl
```

## BR2_EXTERNAL/package/python-pytest-randomly/Config.in
```kconfig
# vim: noexpandtab filetype=make
config BR2_PACKAGE_PYTHON_PYTHON_PYTEST_RANDOMLY
	bool "python-pytest-randomly"
	depends on BR2_PACKAGE_PYTHON3
	select BR2_PACKAGE_PYTHON_PYTEST
	select BR2_PACKAGE_PYTHON_IMPORTLIB_METADATA
	help
	  Pytest plugin to randomly order tests and control random.seed.

	  https://github.com/pytest-dev/pytest-randomly
```

## BR2_EXTERNAL/package/python-pytest-timeout/Config.in
```kconfig
# vim: noexpandtab filetype=make
config BR2_PACKAGE_PYTHON_PYTHON_PYTEST_TIMEOUT
	bool "python-pytest-timeout"
	depends on BR2_PACKAGE_PYTHON3
	select BR2_PACKAGE_PYTHON_PYTEST
	help
	  py.test plugin to abort hanging tests

	  http://github.com/pytest-dev/pytest-timeout/
```

## BR2_EXTERNAL/package/python-pytest-xdist/Config.in
```kconfig
# vim: noexpandtab filetype=make
config BR2_PACKAGE_PYTHON_PYTEST_XDIST
	bool "python-pytest-xdist"
	select BR2_PACKAGE_PYTHON_EXECNET
	select BR2_PACKAGE_PYTHON_PYTEST
	select BR2_PACKAGE_PYTHON_PYTEST_FORKED
	select BR2_PACKAGE_PYTHON_SIX
	select BR2_PACKAGE_PYTHON_FILELOCK
	help
	  pytest xdist plugin for distributed testing and loop-on-failing modes

	  https://github.com/pytest-dev/pytest-xdist
```

## BR2_EXTERNAL/package/python-pytest/Config.in
```kconfig
# vim: noexpandtab filetype=make
config BR2_PACKAGE_PYTHON_PYTEST
	bool "python-pytest"
	select BR2_PACKAGE_PYTHON_PY
	select BR2_PACKAGE_PYTHON_PACKAGING
	select BR2_PACKAGE_PYTHON_ATTRS
	select BR2_PACKAGE_PYTHON_MORE_ITERTOOLS
	select BR2_PACKAGE_PYTHON_PLUGGY
	select BR2_PACKAGE_PYTHON_WCWIDTH
	select BR2_PACKAGE_PYTHON_PATHLIB2
	select BR2_PACKAGE_PYTHON_IMPORTLIB_METADATA
	select BR2_PACKAGE_PYTHON_ATOMICWRITES
	select BR2_PACKAGE_PYTHON_COLORAMA
	select BR2_PACKAGE_PYTHON_MYPY
	select BR2_PACKAGE_PYTHON_ARGCOMPLETE
	select BR2_PACKAGE_PYTHON_HYPOTHESIS
	select BR2_PACKAGE_PYTHON_MOCK
	select BR2_PACKAGE_PYTHON_NOSE
	select BR2_PACKAGE_PYTHON_REQUESTS
	select BR2_PACKAGE_PYTHON_XMLSCHEMA
	help
	  pytest: simple powerful testing with Python

	  https://docs.pytest.org/en/latest/
```

## BR2_EXTERNAL/package/python-python-dateutil/Config.in
```kconfig
# vim: noexpandtab filetype=make
config BR2_PACKAGE_PYTHON_PYTHON_DATEUTIL
	bool "python-python-dateutil"
	select BR2_PACKAGE_PYTHON_SIX # (>=1.5); 
	help
	  Extensions to the standard Python datetime module

	  https://dateutil.readthedocs.io
```

## BR2_EXTERNAL/package/python-python-openid/Config.in
```kconfig
# vim: noexpandtab filetype=make
config BR2_PACKAGE_PYTHON_PYTHON_OPENID
	bool "python-python-openid"
	help
	  OpenID support for servers and consumers.

	  http://github.com/openid/python-openid
```

## BR2_EXTERNAL/package/python-python-subunit/Config.in
```kconfig
# vim: noexpandtab filetype=make
config BR2_PACKAGE_PYTHON_PYTHON_PYTHON_SUBUNIT
	bool "python-python-subunit"
	depends on BR2_PACKAGE_PYTHON3
	help
	  Python implementation of subunit test streaming protocol

	  http://launchpad.net/subunit
```

## BR2_EXTERNAL/package/python-readme-renderer/Config.in
```kconfig
# vim: noexpandtab filetype=make
config BR2_PACKAGE_PYTHON_README_RENDERER
	bool "python-readme-renderer"
	select BR2_PACKAGE_PYTHON_BLEACH
	select BR2_PACKAGE_PYTHON_DOCUTILS
	select BR2_PACKAGE_PYTHON_PYGMENTS
	select BR2_PACKAGE_PYTHON_SIX
	select BR2_PACKAGE_PYTHON_CMARKGFM
	help
	  readme_renderer is a library for rendering "readme" descriptions for Warehouse

	  https://github.com/pypa/readme_renderer
```

## BR2_EXTERNAL/package/python-reno/Config.in
```kconfig
# vim: noexpandtab filetype=make
config BR2_PACKAGE_PYTHON_RENO
	bool "python-reno"
	depends on BR2_PACKAGE_PYTHON3
	select BR2_PACKAGE_PYTHON_PBR
	select BR2_PACKAGE_PYTHON_PYYAML
	select BR2_PACKAGE_PYTHON_DULWICH
	select BR2_PACKAGE_PYTHON_SPHINX
	select BR2_PACKAGE_PYTHON_DOCUTILS
	help
	  RElease NOtes manager

	  https://docs.openstack.org/reno/latest/
```

## BR2_EXTERNAL/package/python-repoze.lru/Config.in
```kconfig
# vim: noexpandtab filetype=make
config BR2_PACKAGE_PYTHON_REPOZELRU
	bool "python-repoze.lru"
	help
	  A tiny LRU cache implementation and decorator

	  http://www.repoze.org
```
