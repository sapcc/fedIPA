## BR2_EXTERNAL/Config.in
```kconfig
source "$BR2_EXTERNAL_TINYIPA_PATH/package/python-debtcollector/Config.in
source "$BR2_EXTERNAL_TINYIPA_PATH/package/python-eventlet/Config.in
source "$BR2_EXTERNAL_TINYIPA_PATH/package/python-fasteners/Config.in
source "$BR2_EXTERNAL_TINYIPA_PATH/package/python-fixtures/Config.in
source "$BR2_EXTERNAL_TINYIPA_PATH/package/python-greenlet/Config.in
source "$BR2_EXTERNAL_TINYIPA_PATH/package/python-ironic-lib/Config.in
source "$BR2_EXTERNAL_TINYIPA_PATH/package/python-ironic-python-agent/Config.in
source "$BR2_EXTERNAL_TINYIPA_PATH/package/python-monotonic/Config.in
source "$BR2_EXTERNAL_TINYIPA_PATH/package/python-oslo.concurrency/Config.in
source "$BR2_EXTERNAL_TINYIPA_PATH/package/python-oslo.config/Config.in
source "$BR2_EXTERNAL_TINYIPA_PATH/package/python-oslo.context/Config.in
source "$BR2_EXTERNAL_TINYIPA_PATH/package/python-oslo.i18n/Config.in
source "$BR2_EXTERNAL_TINYIPA_PATH/package/python-oslo.log/Config.in
source "$BR2_EXTERNAL_TINYIPA_PATH/package/python-oslo.serialization/Config.in
source "$BR2_EXTERNAL_TINYIPA_PATH/package/python-oslo.service/Config.in
source "$BR2_EXTERNAL_TINYIPA_PATH/package/python-oslo.utils/Config.in
source "$BR2_EXTERNAL_TINYIPA_PATH/package/python-paste/Config.in
source "$BR2_EXTERNAL_TINYIPA_PATH/package/python-pastedeploy/Config.in
source "$BR2_EXTERNAL_TINYIPA_PATH/package/python-pint/Config.in
source "$BR2_EXTERNAL_TINYIPA_PATH/package/python-python-dateutil/Config.in
source "$BR2_EXTERNAL_TINYIPA_PATH/package/python-python-openid/Config.in
source "$BR2_EXTERNAL_TINYIPA_PATH/package/python-repoze.lru/Config.in
source "$BR2_EXTERNAL_TINYIPA_PATH/package/python-rfc3986/Config.in
source "$BR2_EXTERNAL_TINYIPA_PATH/package/python-routes/Config.in
source "$BR2_EXTERNAL_TINYIPA_PATH/package/python-stevedore/Config.in
source "$BR2_EXTERNAL_TINYIPA_PATH/package/python-systemd-python/Config.in
source "$BR2_EXTERNAL_TINYIPA_PATH/package/python-uncertainties/Config.in
source "$BR2_EXTERNAL_TINYIPA_PATH/package/python-yappi/Config.in
```

## BR2_EXTERNAL/package/python-Babel/Config.in
```kconfig
# vim: noexpandtab filetype=make
config BR2_PACKAGE_PYTHON_BABEL
	bool "python-Babel"
	select BR2_PACKAGE_PYTHON_PYTZ
	help
	  Collection of utilities that assist with internationalizing and localizing Python applications.
	  
	  http://babel.pocoo.org/
```

## BR2_EXTERNAL/package/python-alabaster/Config.in
```kconfig
# vim: noexpandtab filetype=make
config BR2_PACKAGE_PYTHON_ALABASTER
	bool "python-alabaster"
	help
	  A configurable sidebar-enabled Sphinx theme

	  https://alabaster.readthedocs.io
```

## BR2_EXTERNAL/package/python-alembic/Config.in
```kconfig
# vim: noexpandtab filetype=make
config BR2_PACKAGE_PYTHON_PYTHON_ALEMBIC
	bool "python-alembic"
	help
	  A database migration tool for SQLAlchemy.

	  https://alembic.sqlalchemy.org
```

## BR2_EXTERNAL/package/python-apipkg/Config.in
```kconfig
# vim: noexpandtab filetype=make
config BR2_PACKAGE_PYTHON_APIPKG
	bool "python-apipkg"
	help
	  apipkg: namespace control and lazy-import mechanism

	  https://github.com/pytest-dev/apipkg
```

## BR2_EXTERNAL/package/python-argcomplete/Config.in
```kconfig
# vim: noexpandtab filetype=make
config BR2_PACKAGE_PYTHON_PYTHON_ARGCOMPLETE
	bool "python-argcomplete"
	select BR2_PACKAGE_PYTHON_IMPORTLIB_METADATA
	select BR2_PACKAGE_PYTHON_IMPORTLIB_METADATA
	select BR2_PACKAGE_PYTHON_IMPORTLIB_METADATA
	select BR2_PACKAGE_PYTHON_IMPORTLIB_METADATA
	select BR2_PACKAGE_PYTHON_COVERAGE
	select BR2_PACKAGE_PYTHON_FLAKE8
	select BR2_PACKAGE_PYTHON_PEXPECT
	select BR2_PACKAGE_PYTHON_WHEEL
	help
	  Bash tab completion for argparse

	  https://github.com/kislyuk/argcomplete
```

## BR2_EXTERNAL/package/python-atomicwrites/Config.in
```kconfig
# vim: noexpandtab filetype=make
config BR2_PACKAGE_PYTHON_ATOMICWRITES
	bool "python-atomicwrites"
	help
	  Atomic file writes.

	  https://github.com/untitaker/python-atomicwrites
```

## BR2_EXTERNAL/package/python-bandit/Config.in
```kconfig
# vim: noexpandtab filetype=make
config BR2_PACKAGE_PYTHON_PYTHON_BANDIT
	bool "python-bandit"
	help
	  Security oriented static analyser for python code.

	  https://bandit.readthedocs.io/en/latest/
```

## BR2_EXTERNAL/package/python-bleach/Config.in
```kconfig
# vim: noexpandtab filetype=make
config BR2_PACKAGE_PYTHON_BLEACH
	bool "python-bleach"
	select BR2_PACKAGE_PYTHON_SIX
	select BR2_PACKAGE_PYTHON_WEBENCODINGS
	help
	  An easy safelist-based HTML-sanitizing tool.

	  https://github.com/mozilla/bleach
```

## BR2_EXTERNAL/package/python-blurb/Config.in
```kconfig
# vim: noexpandtab filetype=make
config BR2_PACKAGE_PYTHON_BLURB
	bool "python-blurb"
	help
	  Command-line tool to manage CPython Misc/NEWS.d entries.

	  https://github.com/python/core-workflow/tree/master/blurb
```

## BR2_EXTERNAL/package/python-brotlipy/Config.in
```kconfig
# vim: noexpandtab filetype=make
config BR2_PACKAGE_PYTHON_BROTLIPY
	bool "python-brotlipy"
	select BR2_PACKAGE_PYTHON_CFFI # runtime
	help
	  Python binding to the Brotli library

	  https://github.com/python-hyper/brotlipy/
```

## BR2_EXTERNAL/package/python-cfgv/Config.in
```kconfig
# vim: noexpandtab filetype=make
config BR2_PACKAGE_PYTHON_CFGV
	bool "python-cfgv"
	depends on BR2_PACKAGE_PYTHON3
	help
	  Validate configuration and produce human readable error messages.

	  https://github.com/asottile/cfgv
```

## BR2_EXTERNAL/package/python-cliff/Config.in
```kconfig
# vim: noexpandtab filetype=make
config BR2_PACKAGE_PYTHON_PYTHON_CLIFF
	bool "python-cliff"
	depends on BR2_PACKAGE_PYTHON3
	select BR2_PACKAGE_PYTHON_PBR
	select BR2_PACKAGE_PYTHON_CMD2
	select BR2_PACKAGE_PYTHON_PRETTYTABLE
	select BR2_PACKAGE_PYTHON_PYPARSING
	select BR2_PACKAGE_PYTHON_SIX
	select BR2_PACKAGE_PYTHON_STEVEDORE
	select BR2_PACKAGE_PYTHON_PYYAML
	help
	  Command Line Interface Formulation Framework

	  https://docs.openstack.org/cliff/latest/
```

## BR2_EXTERNAL/package/python-cmarkgfm/Config.in
```kconfig
# vim: noexpandtab filetype=make
config BR2_PACKAGE_PYTHON_PYTHON_CMARKGFM
	bool "python-cmarkgfm"
	help
	  Minimal bindings to GitHub's fork of cmark

	  https://github.com/jonparrott/cmarkgfm
```

## BR2_EXTERNAL/package/python-cmd2/Config.in
```kconfig
# vim: noexpandtab filetype=make
config BR2_PACKAGE_PYTHON_CMD2
	bool "python-cmd2"
	depends on BR2_PACKAGE_PYTHON3
	select BR2_PACKAGE_PYTHON_ATTRS
	select BR2_PACKAGE_PYTHON_COLORAMA
	select BR2_PACKAGE_PYTHON_PYPERCLIP
	select BR2_PACKAGE_PYTHON_SETUPTOOLS
	select BR2_PACKAGE_PYTHON_WCWIDTH
	select BR2_PACKAGE_PYTHON_PYREADLINE
	select BR2_PACKAGE_PYTHON_PYTEST
	select BR2_PACKAGE_PYTHON_CODECOV
	select BR2_PACKAGE_PYTHON_PYTEST_COV
	select BR2_PACKAGE_PYTHON_PYTEST_MOCK
	select BR2_PACKAGE_PYTHON_TOX
	select BR2_PACKAGE_PYTHON_FLAKE8
	select BR2_PACKAGE_PYTHON_SPHINX
	select BR2_PACKAGE_PYTHON_SPHINX_RTD_THEME
	select BR2_PACKAGE_PYTHON_SPHINX_AUTOBUILD
	select BR2_PACKAGE_PYTHON_DOC8
	select BR2_PACKAGE_PYTHON_INVOKE
	select BR2_PACKAGE_PYTHON_TWINE
	select BR2_PACKAGE_PYTHON_MOCK
	help
	  cmd2 - quickly build feature-rich and user-friendly interactive command line applications in Python

	  https://github.com/python-cmd2/cmd2
```

## BR2_EXTERNAL/package/python-codecov/Config.in
```kconfig
# vim: noexpandtab filetype=make
config BR2_PACKAGE_PYTHON_CODECOV
	bool "python-codecov"
	select BR2_PACKAGE_PYTHON_REQUESTS
	select BR2_PACKAGE_PYTHON_COVERAGE
	help
	  Hosted coverage reports for GitHub, Bitbucket and Gitlab

	  https://github.com/codecov/codecov-python
```

## BR2_EXTERNAL/package/python-configparser/Config.in
```kconfig
# vim: noexpandtab filetype=make
config BR2_PACKAGE_PYTHON_PYTHON_CONFIGPARSER
	bool "python-configparser"
	depends on BR2_PACKAGE_PYTHON3
	select BR2_PACKAGE_PYTHON_SPHINX
	select BR2_PACKAGE_PYTHON_JARACOPACKAGING
	select BR2_PACKAGE_PYTHON_RSTLINKER
	select BR2_PACKAGE_PYTHON_PYTEST
	select BR2_PACKAGE_PYTHON_PYTEST_CHECKDOCS
	select BR2_PACKAGE_PYTHON_PYTEST_FLAKE8
	select BR2_PACKAGE_PYTHON_PYTEST_BLACK_MULTIPY
	select BR2_PACKAGE_PYTHON_PYTEST_COV
	help
	  Updated configparser from Python 3.8 for Python 2.6+.

	  https://github.com/jaraco/configparser/
```

## BR2_EXTERNAL/package/python-contextlib2/Config.in
```kconfig
# vim: noexpandtab filetype=make
config BR2_PACKAGE_PYTHON_CONTEXTLIB2
	bool "python-contextlib2"
	help
	  Backports and enhancements for the contextlib module

	  http://contextlib2.readthedocs.org
```

## BR2_EXTERNAL/package/python-coverage/Config.in
```kconfig
# vim: noexpandtab filetype=make
config BR2_PACKAGE_PYTHON_PYTHON_COVERAGE
	bool "python-coverage"
	select BR2_PACKAGE_PYTHON_TOML
	help
	  Code coverage measurement for Python

	  https://github.com/nedbat/coveragepy
```

## BR2_EXTERNAL/package/python-daiquiri/Config.in
```kconfig
# vim: noexpandtab filetype=make
config BR2_PACKAGE_PYTHON_PYTHON_DAIQUIRI
	bool "python-daiquiri"
	help
	  Library to configure Python logging easily

	  https://github.com/jd/daiquiri
```

## BR2_EXTERNAL/package/python-ddt/Config.in
```kconfig
# vim: noexpandtab filetype=make
config BR2_PACKAGE_PYTHON_DDT
	bool "python-ddt"
	help
	  Data-Driven/Decorated Tests

	  https://github.com/datadriventests/ddt
```

## BR2_EXTERNAL/package/python-debtcollector/Config.in
```kconfig
# vim: noexpandtab filetype=make
config BR2_PACKAGE_PYTHON_DEBTCOLLECTOR
	bool "python-debtcollector"
	depends on BR2_PACKAGE_PYTHON3
	select BR2_PACKAGE_PYTHON_PBR # (!=2.1.0,>=2.0.0); 
	select BR2_PACKAGE_PYTHON_SIX # (>=1.10.0); 
	select BR2_PACKAGE_PYTHON_WRAPT # (>=1.7.0); 
	help
	  A collection of Python deprecation patterns and strategies
	  that help you collect your technical debt in a non-destructive
	  manner.

	  https://docs.openstack.org/debtcollector/latest
```

## BR2_EXTERNAL/package/python-diskimage-builder/Config.in
```kconfig
# vim: noexpandtab filetype=make
config BR2_PACKAGE_PYTHON_DISKIMAGE_BUILDER
	bool "python-diskimage-builder"
	select BR2_PACKAGE_PYTHON_BABEL
	select BR2_PACKAGE_PYTHON_NETWORKX
	select BR2_PACKAGE_PYTHON_PBR
	select BR2_PACKAGE_PYTHON_PYYAML
	select BR2_PACKAGE_PYTHON_SIX
	select BR2_PACKAGE_PYTHON_STEVEDORE
	select BR2_PACKAGE_PYTHON_FLAKE8
	help
	  This repository has the core functionality for building such images, both virtual and bare metal
	  
	  https://docs.openstack.org/diskimage-builder/latest/
```

## BR2_EXTERNAL/package/python-distlib/Config.in
```kconfig
# vim: noexpandtab filetype=make
config BR2_PACKAGE_PYTHON_PYTHON_DISTLIB
	bool "python-distlib"
	help
	  Distribution utilities

	  https://bitbucket.org/pypa/distlib
```

## BR2_EXTERNAL/package/python-doc8/Config.in
```kconfig
# vim: noexpandtab filetype=make
config BR2_PACKAGE_PYTHON_DOC8
	bool "python-doc8"
	select BR2_PACKAGE_PYTHON_CHARDET
	select BR2_PACKAGE_PYTHON_DOCUTILS
	select BR2_PACKAGE_PYTHON_RESTRUCTUREDTEXT_LINT
	select BR2_PACKAGE_PYTHON_SIX
	select BR2_PACKAGE_PYTHON_STEVEDORE
	help
	  Style checker for Sphinx (or other) RST documentation

	  https://launchpad.net/doc8
```
